VERSION ""

NS_ :

BS_:

BU_: ADAS RADAR XXX

BO_ 98 TRACK_0: 64 XXX
 SG_ COUNTER_1 : 23|8@0+ (1,0) [0|31] "" XXX
 SG_ COUNTER_2 : 27|4@0+ (1,0) [0|15] "" XXX

BO_ 100 TRACK_1: 64 XXX
 SG_ COUNTER_1 : 23|8@0+ (1,0) [0|31] "" XXX
 SG_ COUNTER_2 : 27|4@0+ (1,0) [0|15] "" XXX

BO_ 102 TRACK_2: 64 XXX
 SG_ COUNTER_1 : 23|8@0+ (1,0) [0|31] "" XXX
 SG_ COUNTER_2 : 27|4@0+ (1,0) [0|15] "" XXX

BO_ 104 TRACK_3: 64 XXX
 SG_ COUNTER_1 : 23|8@0+ (1,0) [0|31] "" XXX
 SG_ COUNTER_2 : 27|4@0+ (1,0) [0|15] "" XXX

BO_ 106 TRACK_4: 64 XXX
 SG_ COUNTER_1 : 23|8@0+ (1,0) [0|31] "" XXX
 SG_ COUNTER_2 : 27|4@0+ (1,0) [0|15] "" XXX

BO_ 108 TRACK_5: 64 XXX
 SG_ COUNTER_1 : 23|8@0+ (1,0) [0|31] "" XXX
 SG_ COUNTER_2 : 27|4@0+ (1,0) [0|15] "" XXX

BO_ 110 TRACK_6: 64 XXX
 SG_ COUNTER_1 : 23|8@0+ (1,0) [0|31] "" XXX
 SG_ COUNTER_2 : 27|4@0+ (1,0) [0|15] "" XXX

BO_ 112 TRACK_7: 64 XXX
 SG_ COUNTER_1 : 23|8@0+ (1,0) [0|31] "" XXX
 SG_ COUNTER_2 : 27|4@0+ (1,0) [0|15] "" XXX

BO_ 114 TRACK_8: 64 XXX
 SG_ COUNTER_1 : 23|8@0+ (1,0) [0|31] "" XXX
 SG_ COUNTER_2 : 27|4@0+ (1,0) [0|15] "" XXX

BO_ 116 TRACK_9: 64 XXX
 SG_ COUNTER_1 : 23|8@0+ (1,0) [0|31] "" XXX
 SG_ COUNTER_2 : 27|4@0+ (1,0) [0|15] "" XXX

BO_ 118 TRACK_10: 64 XXX
 SG_ COUNTER_1 : 23|8@0+ (1,0) [0|31] "" XXX
 SG_ COUNTER_2 : 27|4@0+ (1,0) [0|15] "" XXX

BO_ 120 TRACK_11: 64 XXX
 SG_ COUNTER_1 : 23|8@0+ (1,0) [0|31] "" XXX
 SG_ COUNTER_2 : 27|4@0+ (1,0) [0|15] "" XXX

BO_ 122 TRACK_12: 64 XXX
 SG_ COUNTER_1 : 23|8@0+ (1,0) [0|31] "" XXX
 SG_ COUNTER_2 : 27|4@0+ (1,0) [0|15] "" XXX

BO_ 124 TRACK_13: 64 XXX
 SG_ COUNTER_1 : 23|8@0+ (1,0) [0|31] "" XXX
 SG_ COUNTER_2 : 27|4@0+ (1,0) [0|15] "" XXX

BO_ 126 TRACK_14: 64 XXX
 SG_ COUNTER_1 : 23|8@0+ (1,0) [0|31] "" XXX
 SG_ COUNTER_2 : 27|4@0+ (1,0) [0|15] "" XXX

BO_ 128 TRACK_15: 64 XXX
 SG_ COUNTER_1 : 23|8@0+ (1,0) [0|31] "" XXX
 SG_ COUNTER_2 : 27|4@0+ (1,0) [0|15] "" XXX
