VERSION ""

NS_ :

BS_:

BU_: EBCM NEO CAM RADAR PCM EPS VSA SCM BDY XXX EPB

BO_ 318255408 TIMER_1: 3 XXX //0x12F83130
 SG_ COUNTER : 21|2@0+ (1,0) [0|3] "" NEO
 SG_ CHECKSUM : 19|4@0+ (1,0) [0|15] "" NEO

BO_ 318284336 TIMER_2: 3 XXX //0x12F8A230
 SG_ COUNTER : 21|2@0+ (1,0) [0|3] "" NEO
 SG_ CHECKSUM : 19|4@0+ (1,0) [0|15] "" NEO
