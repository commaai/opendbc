BO_ 512 EPS_INTERCEPTOR: 2 EON
 SG_ SPEED_NULLER : 7|1@0+ (1,0) [0|1] "" XXX
 SG_ CHECKSUM : 15|8@0+ (1,0) [0|255] "" XXX
