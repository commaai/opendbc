VERSION ""

NS_ :

BS_:

BU_: XXX

BO_ 273 NEW_MSG_1: 8 XXX
 SG_ NEW_SIGNAL_1 : 7|2@0+ (1,0) [0|3] "" XXX

BO_ 688 USER_TORQUE: 5 XXX
