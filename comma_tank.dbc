VERSION ""

BO_ 514 TANK_COMMAND: 4 EON
  SG_ SPEED_LEFT : 7|16@0+ (1,-32768) [-32768|32767] "" TANKBOARD
  SG_ SPEED_RIGHT : 23|16@0+ (1,-32768) [-32768|32767] "" TANKBOARD
