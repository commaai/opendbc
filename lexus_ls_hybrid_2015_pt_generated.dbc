VERSION ""

NS_ :

BS_:

BU_: XXX

BO_ 740 NEW_MSG_1: 8 XXX
 SG_ NEW_SIGNAL_1 : 7|14@0+ (1,0) [0|1] "" XXX
 SG_ NEW_SIGNAL_2 : 6|1@0+ (1,0) [0|1] "" XXX

BO_ 608 NEW_MSG_2: 8 XXX
