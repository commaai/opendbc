VERSION ""

NS_ :

BS_:

BU_: XXX

BO_ 573 ENGINE_1: 8 XXX
 SG_ Pedal_position : 8|8@1+ (0.392,0) [0|255] "%" XXX
 SG_ RPM : 24|16@1+ (3.15,0) [0|45000] "R/min" XXX
