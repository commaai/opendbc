VERSION ""

NS_ :

BS_:

BU_: XXX

BO_ 320 Throttle: 8 XXX
 SG_ ThrottlePosition : 7|8@0+ (1,0) [0|255] "" XXX

BO_ 209 NEW_MSG_1: 8 XXX
 SG_ BrakePosition : 23|8@0+ (1,0) [0|255] "" XXX
