VERSION ""

NS_ :

BS_:

BU_: XXX

BO_ 944 AMB_AIR_T: 6 XXX
 SG_ OUT_AIR_T : 24|8@1+ (1,-48) [8|98] "°C" XXX

CM_ SG_ 944 OUT_AIR_T "Outside air temperature value displayed on the combination meter. Sent once/second. Data is in °C, converted to °F and rounded to the nearest whole number by the combination meter on USDM cars.";
