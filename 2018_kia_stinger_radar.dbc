VERSION ""

NS_ :

BS_:

BU_: XXX

BO_ 570 NEW_MSG_1: 8 XXX
 SG_ NEW_SIGNAL_1 : 8|8@1+ (1,0) [0|255] "" XXX
 SG_ DISTANCE : 24|8@1+ (1,0) [0|255] "" XXX
