VERSION "ParkAssistCAN"

NS_ :

BS_:

BU_: ACM FCM

BO_ 533 LEAD_INFO: 8 XXX
 SG_ UNKNOWN_1 : 6|63@0+ (1,0) [0|9.22337203685478e+18] "" XXX
 SG_ LEAD_CAR : 7|1@0+ (1,0) [0|1] "" XXX
