VERSION ""

NS_ :

BS_:

BU_: XXX

BO_ 528 RADAR_TRACK_210: 32 RADAR
 SG_ CHECKSUM : 0|16@1+ (1,0) [0|65535] "" XXX
 SG_ COUNTER : 16|8@1+ (1,0) [0|255] "" XXX
 SG_ NEW_SIGNAL_1 : 25|2@0+ (1,0) [0|3] "" XXX
 SG_ NEW_SIGNAL_3 : 28|2@0+ (1,0) [0|3] "" XXX
 SG_ COUNTER_3 : 31|2@0+ (1,0) [0|3] "" XXX
 SG_ NEW_SIGNAL_2 : 38|7@0- (1,0) [0|127] "" XXX
 SG_ COUNTER_256 : 47|8@0+ (1,0) [0|255] "" XXX
 SG_ NEW_SIGNAL_6 : 51|4@0+ (1,0) [0|15] "" XXX
 SG_ STATE : 54|3@0+ (1,0) [0|7] "" XXX
 SG_ NEW_SIGNAL_8 : 62|7@0- (1,0) [0|127] "" XXX
 SG_ LONG_DIST : 63|13@1+ (0.05,0) [0|8191] "m" XXX
 SG_ LAT_DIST : 76|12@1- (0.05,0) [0|127] "" XXX
 SG_ REL_SPEED : 88|14@1- (0.01,0) [0|16383] "" XXX
 SG_ NEW_SIGNAL_4 : 103|2@0+ (1,0) [0|3] "" XXX
 SG_ LAT_DIST_ACCEL : 104|13@1- (1,0) [0|8191] "" XXX
 SG_ REL_ACCEL : 118|10@1- (0.02,0) [0|1023] "" XXX
 SG_ NEW_SIGNAL_5 : 133|4@0+ (1,0) [0|15] "" XXX
 SG_ NEW_SIGNAL_1_2 : 153|2@0+ (1,0) [0|3] "" XXX
 SG_ NEW_SIGNAL_3_2 : 156|2@0+ (1,0) [0|3] "" XXX
 SG_ NEW_SIGNAL_2_2 : 166|7@0- (1,0) [0|127] "" XXX
 SG_ COUNTER_256_2 : 175|8@0+ (1,0) [0|255] "" XXX
 SG_ NEW_SIGNAL_6_2 : 179|4@0+ (1,0) [0|15] "" XXX
 SG_ STATE_2 : 182|3@0+ (1,0) [0|7] "" XXX
 SG_ NEW_SIGNAL_8_2 : 190|7@0- (1,0) [0|127] "" XXX
 SG_ LONG_DIST_2 : 191|13@1+ (0.05,0) [0|8191] "m" XXX
 SG_ LAT_DIST_2 : 204|12@1- (0.05,0) [0|127] "" XXX
 SG_ REL_SPEED_2 : 216|14@1- (0.01,0) [0|16383] "" XXX
 SG_ NEW_SIGNAL_4_2 : 231|2@0+ (1,0) [0|3] "" XXX
 SG_ LAT_DIST_ACCEL_2 : 232|13@1- (1,0) [0|8191] "" XXX
 SG_ REL_ACCEL_2 : 246|10@1- (0.02,0) [0|1023] "" XXX

BO_ 529 RADAR_TRACK_211: 32 RADAR
 SG_ CHECKSUM : 0|16@1+ (1,0) [0|65535] "" XXX
 SG_ COUNTER : 16|8@1+ (1,0) [0|255] "" XXX
 SG_ NEW_SIGNAL_1 : 25|2@0+ (1,0) [0|3] "" XXX
 SG_ NEW_SIGNAL_3 : 28|2@0+ (1,0) [0|3] "" XXX
 SG_ COUNTER_3 : 31|2@0+ (1,0) [0|3] "" XXX
 SG_ NEW_SIGNAL_2 : 38|7@0- (1,0) [0|127] "" XXX
 SG_ COUNTER_256 : 47|8@0+ (1,0) [0|255] "" XXX
 SG_ NEW_SIGNAL_6 : 51|4@0+ (1,0) [0|15] "" XXX
 SG_ STATE : 54|3@0+ (1,0) [0|7] "" XXX
 SG_ NEW_SIGNAL_8 : 62|7@0- (1,0) [0|127] "" XXX
 SG_ LONG_DIST : 63|13@1+ (0.05,0) [0|8191] "m" XXX
 SG_ LAT_DIST : 76|12@1- (0.05,0) [0|127] "" XXX
 SG_ REL_SPEED : 88|14@1- (0.01,0) [0|16383] "" XXX
 SG_ NEW_SIGNAL_4 : 103|2@0+ (1,0) [0|3] "" XXX
 SG_ LAT_DIST_ACCEL : 104|13@1- (1,0) [0|8191] "" XXX
 SG_ REL_ACCEL : 118|10@1- (0.02,0) [0|1023] "" XXX
 SG_ NEW_SIGNAL_5 : 133|4@0+ (1,0) [0|15] "" XXX
 SG_ NEW_SIGNAL_1_2 : 153|2@0+ (1,0) [0|3] "" XXX
 SG_ NEW_SIGNAL_3_2 : 156|2@0+ (1,0) [0|3] "" XXX
 SG_ NEW_SIGNAL_2_2 : 166|7@0- (1,0) [0|127] "" XXX
 SG_ COUNTER_256_2 : 175|8@0+ (1,0) [0|255] "" XXX
 SG_ NEW_SIGNAL_6_2 : 179|4@0+ (1,0) [0|15] "" XXX
 SG_ STATE_2 : 182|3@0+ (1,0) [0|7] "" XXX
 SG_ NEW_SIGNAL_8_2 : 190|7@0- (1,0) [0|127] "" XXX
 SG_ LONG_DIST_2 : 191|13@1+ (0.05,0) [0|8191] "m" XXX
 SG_ LAT_DIST_2 : 204|12@1- (0.05,0) [0|127] "" XXX
 SG_ REL_SPEED_2 : 216|14@1- (0.01,0) [0|16383] "" XXX
 SG_ NEW_SIGNAL_4_2 : 231|2@0+ (1,0) [0|3] "" XXX
 SG_ LAT_DIST_ACCEL_2 : 232|13@1- (1,0) [0|8191] "" XXX
 SG_ REL_ACCEL_2 : 246|10@1- (0.02,0) [0|1023] "" XXX

BO_ 530 RADAR_TRACK_212: 32 RADAR
 SG_ CHECKSUM : 0|16@1+ (1,0) [0|65535] "" XXX
 SG_ COUNTER : 16|8@1+ (1,0) [0|255] "" XXX
 SG_ NEW_SIGNAL_1 : 25|2@0+ (1,0) [0|3] "" XXX
 SG_ NEW_SIGNAL_3 : 28|2@0+ (1,0) [0|3] "" XXX
 SG_ COUNTER_3 : 31|2@0+ (1,0) [0|3] "" XXX
 SG_ NEW_SIGNAL_2 : 38|7@0- (1,0) [0|127] "" XXX
 SG_ COUNTER_256 : 47|8@0+ (1,0) [0|255] "" XXX
 SG_ NEW_SIGNAL_6 : 51|4@0+ (1,0) [0|15] "" XXX
 SG_ STATE : 54|3@0+ (1,0) [0|7] "" XXX
 SG_ NEW_SIGNAL_8 : 62|7@0- (1,0) [0|127] "" XXX
 SG_ LONG_DIST : 63|13@1+ (0.05,0) [0|8191] "m" XXX
 SG_ LAT_DIST : 76|12@1- (0.05,0) [0|127] "" XXX
 SG_ REL_SPEED : 88|14@1- (0.01,0) [0|16383] "" XXX
 SG_ NEW_SIGNAL_4 : 103|2@0+ (1,0) [0|3] "" XXX
 SG_ LAT_DIST_ACCEL : 104|13@1- (1,0) [0|8191] "" XXX
 SG_ REL_ACCEL : 118|10@1- (0.02,0) [0|1023] "" XXX
 SG_ NEW_SIGNAL_5 : 133|4@0+ (1,0) [0|15] "" XXX
 SG_ NEW_SIGNAL_1_2 : 153|2@0+ (1,0) [0|3] "" XXX
 SG_ NEW_SIGNAL_3_2 : 156|2@0+ (1,0) [0|3] "" XXX
 SG_ NEW_SIGNAL_2_2 : 166|7@0- (1,0) [0|127] "" XXX
 SG_ COUNTER_256_2 : 175|8@0+ (1,0) [0|255] "" XXX
 SG_ NEW_SIGNAL_6_2 : 179|4@0+ (1,0) [0|15] "" XXX
 SG_ STATE_2 : 182|3@0+ (1,0) [0|7] "" XXX
 SG_ NEW_SIGNAL_8_2 : 190|7@0- (1,0) [0|127] "" XXX
 SG_ LONG_DIST_2 : 191|13@1+ (0.05,0) [0|8191] "m" XXX
 SG_ LAT_DIST_2 : 204|12@1- (0.05,0) [0|127] "" XXX
 SG_ REL_SPEED_2 : 216|14@1- (0.01,0) [0|16383] "" XXX
 SG_ NEW_SIGNAL_4_2 : 231|2@0+ (1,0) [0|3] "" XXX
 SG_ LAT_DIST_ACCEL_2 : 232|13@1- (1,0) [0|8191] "" XXX
 SG_ REL_ACCEL_2 : 246|10@1- (0.02,0) [0|1023] "" XXX

BO_ 531 RADAR_TRACK_213: 32 RADAR
 SG_ CHECKSUM : 0|16@1+ (1,0) [0|65535] "" XXX
 SG_ COUNTER : 16|8@1+ (1,0) [0|255] "" XXX
 SG_ NEW_SIGNAL_1 : 25|2@0+ (1,0) [0|3] "" XXX
 SG_ NEW_SIGNAL_3 : 28|2@0+ (1,0) [0|3] "" XXX
 SG_ COUNTER_3 : 31|2@0+ (1,0) [0|3] "" XXX
 SG_ NEW_SIGNAL_2 : 38|7@0- (1,0) [0|127] "" XXX
 SG_ COUNTER_256 : 47|8@0+ (1,0) [0|255] "" XXX
 SG_ NEW_SIGNAL_6 : 51|4@0+ (1,0) [0|15] "" XXX
 SG_ STATE : 54|3@0+ (1,0) [0|7] "" XXX
 SG_ NEW_SIGNAL_8 : 62|7@0- (1,0) [0|127] "" XXX
 SG_ LONG_DIST : 63|13@1+ (0.05,0) [0|8191] "m" XXX
 SG_ LAT_DIST : 76|12@1- (0.05,0) [0|127] "" XXX
 SG_ REL_SPEED : 88|14@1- (0.01,0) [0|16383] "" XXX
 SG_ NEW_SIGNAL_4 : 103|2@0+ (1,0) [0|3] "" XXX
 SG_ LAT_DIST_ACCEL : 104|13@1- (1,0) [0|8191] "" XXX
 SG_ REL_ACCEL : 118|10@1- (0.02,0) [0|1023] "" XXX
 SG_ NEW_SIGNAL_5 : 133|4@0+ (1,0) [0|15] "" XXX
 SG_ NEW_SIGNAL_1_2 : 153|2@0+ (1,0) [0|3] "" XXX
 SG_ NEW_SIGNAL_3_2 : 156|2@0+ (1,0) [0|3] "" XXX
 SG_ NEW_SIGNAL_2_2 : 166|7@0- (1,0) [0|127] "" XXX
 SG_ COUNTER_256_2 : 175|8@0+ (1,0) [0|255] "" XXX
 SG_ NEW_SIGNAL_6_2 : 179|4@0+ (1,0) [0|15] "" XXX
 SG_ STATE_2 : 182|3@0+ (1,0) [0|7] "" XXX
 SG_ NEW_SIGNAL_8_2 : 190|7@0- (1,0) [0|127] "" XXX
 SG_ LONG_DIST_2 : 191|13@1+ (0.05,0) [0|8191] "m" XXX
 SG_ LAT_DIST_2 : 204|12@1- (0.05,0) [0|127] "" XXX
 SG_ REL_SPEED_2 : 216|14@1- (0.01,0) [0|16383] "" XXX
 SG_ NEW_SIGNAL_4_2 : 231|2@0+ (1,0) [0|3] "" XXX
 SG_ LAT_DIST_ACCEL_2 : 232|13@1- (1,0) [0|8191] "" XXX
 SG_ REL_ACCEL_2 : 246|10@1- (0.02,0) [0|1023] "" XXX

BO_ 532 RADAR_TRACK_214: 32 RADAR
 SG_ CHECKSUM : 0|16@1+ (1,0) [0|65535] "" XXX
 SG_ COUNTER : 16|8@1+ (1,0) [0|255] "" XXX
 SG_ NEW_SIGNAL_1 : 25|2@0+ (1,0) [0|3] "" XXX
 SG_ NEW_SIGNAL_3 : 28|2@0+ (1,0) [0|3] "" XXX
 SG_ COUNTER_3 : 31|2@0+ (1,0) [0|3] "" XXX
 SG_ NEW_SIGNAL_2 : 38|7@0- (1,0) [0|127] "" XXX
 SG_ COUNTER_256 : 47|8@0+ (1,0) [0|255] "" XXX
 SG_ NEW_SIGNAL_6 : 51|4@0+ (1,0) [0|15] "" XXX
 SG_ STATE : 54|3@0+ (1,0) [0|7] "" XXX
 SG_ NEW_SIGNAL_8 : 62|7@0- (1,0) [0|127] "" XXX
 SG_ LONG_DIST : 63|13@1+ (0.05,0) [0|8191] "m" XXX
 SG_ LAT_DIST : 76|12@1- (0.05,0) [0|127] "" XXX
 SG_ REL_SPEED : 88|14@1- (0.01,0) [0|16383] "" XXX
 SG_ NEW_SIGNAL_4 : 103|2@0+ (1,0) [0|3] "" XXX
 SG_ LAT_DIST_ACCEL : 104|13@1- (1,0) [0|8191] "" XXX
 SG_ REL_ACCEL : 118|10@1- (0.02,0) [0|1023] "" XXX
 SG_ NEW_SIGNAL_5 : 133|4@0+ (1,0) [0|15] "" XXX
 SG_ NEW_SIGNAL_1_2 : 153|2@0+ (1,0) [0|3] "" XXX
 SG_ NEW_SIGNAL_3_2 : 156|2@0+ (1,0) [0|3] "" XXX
 SG_ NEW_SIGNAL_2_2 : 166|7@0- (1,0) [0|127] "" XXX
 SG_ COUNTER_256_2 : 175|8@0+ (1,0) [0|255] "" XXX
 SG_ NEW_SIGNAL_6_2 : 179|4@0+ (1,0) [0|15] "" XXX
 SG_ STATE_2 : 182|3@0+ (1,0) [0|7] "" XXX
 SG_ NEW_SIGNAL_8_2 : 190|7@0- (1,0) [0|127] "" XXX
 SG_ LONG_DIST_2 : 191|13@1+ (0.05,0) [0|8191] "m" XXX
 SG_ LAT_DIST_2 : 204|12@1- (0.05,0) [0|127] "" XXX
 SG_ REL_SPEED_2 : 216|14@1- (0.01,0) [0|16383] "" XXX
 SG_ NEW_SIGNAL_4_2 : 231|2@0+ (1,0) [0|3] "" XXX
 SG_ LAT_DIST_ACCEL_2 : 232|13@1- (1,0) [0|8191] "" XXX
 SG_ REL_ACCEL_2 : 246|10@1- (0.02,0) [0|1023] "" XXX

BO_ 533 RADAR_TRACK_215: 32 RADAR
 SG_ CHECKSUM : 0|16@1+ (1,0) [0|65535] "" XXX
 SG_ COUNTER : 16|8@1+ (1,0) [0|255] "" XXX
 SG_ NEW_SIGNAL_1 : 25|2@0+ (1,0) [0|3] "" XXX
 SG_ NEW_SIGNAL_3 : 28|2@0+ (1,0) [0|3] "" XXX
 SG_ COUNTER_3 : 31|2@0+ (1,0) [0|3] "" XXX
 SG_ NEW_SIGNAL_2 : 38|7@0- (1,0) [0|127] "" XXX
 SG_ COUNTER_256 : 47|8@0+ (1,0) [0|255] "" XXX
 SG_ NEW_SIGNAL_6 : 51|4@0+ (1,0) [0|15] "" XXX
 SG_ STATE : 54|3@0+ (1,0) [0|7] "" XXX
 SG_ NEW_SIGNAL_8 : 62|7@0- (1,0) [0|127] "" XXX
 SG_ LONG_DIST : 63|13@1+ (0.05,0) [0|8191] "m" XXX
 SG_ LAT_DIST : 76|12@1- (0.05,0) [0|127] "" XXX
 SG_ REL_SPEED : 88|14@1- (0.01,0) [0|16383] "" XXX
 SG_ NEW_SIGNAL_4 : 103|2@0+ (1,0) [0|3] "" XXX
 SG_ LAT_DIST_ACCEL : 104|13@1- (1,0) [0|8191] "" XXX
 SG_ REL_ACCEL : 118|10@1- (0.02,0) [0|1023] "" XXX
 SG_ NEW_SIGNAL_5 : 133|4@0+ (1,0) [0|15] "" XXX
 SG_ NEW_SIGNAL_1_2 : 153|2@0+ (1,0) [0|3] "" XXX
 SG_ NEW_SIGNAL_3_2 : 156|2@0+ (1,0) [0|3] "" XXX
 SG_ NEW_SIGNAL_2_2 : 166|7@0- (1,0) [0|127] "" XXX
 SG_ COUNTER_256_2 : 175|8@0+ (1,0) [0|255] "" XXX
 SG_ NEW_SIGNAL_6_2 : 179|4@0+ (1,0) [0|15] "" XXX
 SG_ STATE_2 : 182|3@0+ (1,0) [0|7] "" XXX
 SG_ NEW_SIGNAL_8_2 : 190|7@0- (1,0) [0|127] "" XXX
 SG_ LONG_DIST_2 : 191|13@1+ (0.05,0) [0|8191] "m" XXX
 SG_ LAT_DIST_2 : 204|12@1- (0.05,0) [0|127] "" XXX
 SG_ REL_SPEED_2 : 216|14@1- (0.01,0) [0|16383] "" XXX
 SG_ NEW_SIGNAL_4_2 : 231|2@0+ (1,0) [0|3] "" XXX
 SG_ LAT_DIST_ACCEL_2 : 232|13@1- (1,0) [0|8191] "" XXX
 SG_ REL_ACCEL_2 : 246|10@1- (0.02,0) [0|1023] "" XXX

BO_ 534 RADAR_TRACK_216: 32 RADAR
 SG_ CHECKSUM : 0|16@1+ (1,0) [0|65535] "" XXX
 SG_ COUNTER : 16|8@1+ (1,0) [0|255] "" XXX
 SG_ NEW_SIGNAL_1 : 25|2@0+ (1,0) [0|3] "" XXX
 SG_ NEW_SIGNAL_3 : 28|2@0+ (1,0) [0|3] "" XXX
 SG_ COUNTER_3 : 31|2@0+ (1,0) [0|3] "" XXX
 SG_ NEW_SIGNAL_2 : 38|7@0- (1,0) [0|127] "" XXX
 SG_ COUNTER_256 : 47|8@0+ (1,0) [0|255] "" XXX
 SG_ NEW_SIGNAL_6 : 51|4@0+ (1,0) [0|15] "" XXX
 SG_ STATE : 54|3@0+ (1,0) [0|7] "" XXX
 SG_ NEW_SIGNAL_8 : 62|7@0- (1,0) [0|127] "" XXX
 SG_ LONG_DIST : 63|13@1+ (0.05,0) [0|8191] "m" XXX
 SG_ LAT_DIST : 76|12@1- (0.05,0) [0|127] "" XXX
 SG_ REL_SPEED : 88|14@1- (0.01,0) [0|16383] "" XXX
 SG_ NEW_SIGNAL_4 : 103|2@0+ (1,0) [0|3] "" XXX
 SG_ LAT_DIST_ACCEL : 104|13@1- (1,0) [0|8191] "" XXX
 SG_ REL_ACCEL : 118|10@1- (0.02,0) [0|1023] "" XXX
 SG_ NEW_SIGNAL_5 : 133|4@0+ (1,0) [0|15] "" XXX
 SG_ NEW_SIGNAL_1_2 : 153|2@0+ (1,0) [0|3] "" XXX
 SG_ NEW_SIGNAL_3_2 : 156|2@0+ (1,0) [0|3] "" XXX
 SG_ NEW_SIGNAL_2_2 : 166|7@0- (1,0) [0|127] "" XXX
 SG_ COUNTER_256_2 : 175|8@0+ (1,0) [0|255] "" XXX
 SG_ NEW_SIGNAL_6_2 : 179|4@0+ (1,0) [0|15] "" XXX
 SG_ STATE_2 : 182|3@0+ (1,0) [0|7] "" XXX
 SG_ NEW_SIGNAL_8_2 : 190|7@0- (1,0) [0|127] "" XXX
 SG_ LONG_DIST_2 : 191|13@1+ (0.05,0) [0|8191] "m" XXX
 SG_ LAT_DIST_2 : 204|12@1- (0.05,0) [0|127] "" XXX
 SG_ REL_SPEED_2 : 216|14@1- (0.01,0) [0|16383] "" XXX
 SG_ NEW_SIGNAL_4_2 : 231|2@0+ (1,0) [0|3] "" XXX
 SG_ LAT_DIST_ACCEL_2 : 232|13@1- (1,0) [0|8191] "" XXX
 SG_ REL_ACCEL_2 : 246|10@1- (0.02,0) [0|1023] "" XXX

BO_ 535 RADAR_TRACK_217: 32 RADAR
 SG_ CHECKSUM : 0|16@1+ (1,0) [0|65535] "" XXX
 SG_ COUNTER : 16|8@1+ (1,0) [0|255] "" XXX
 SG_ NEW_SIGNAL_1 : 25|2@0+ (1,0) [0|3] "" XXX
 SG_ NEW_SIGNAL_3 : 28|2@0+ (1,0) [0|3] "" XXX
 SG_ COUNTER_3 : 31|2@0+ (1,0) [0|3] "" XXX
 SG_ NEW_SIGNAL_2 : 38|7@0- (1,0) [0|127] "" XXX
 SG_ COUNTER_256 : 47|8@0+ (1,0) [0|255] "" XXX
 SG_ NEW_SIGNAL_6 : 51|4@0+ (1,0) [0|15] "" XXX
 SG_ STATE : 54|3@0+ (1,0) [0|7] "" XXX
 SG_ NEW_SIGNAL_8 : 62|7@0- (1,0) [0|127] "" XXX
 SG_ LONG_DIST : 63|13@1+ (0.05,0) [0|8191] "m" XXX
 SG_ LAT_DIST : 76|12@1- (0.05,0) [0|127] "" XXX
 SG_ REL_SPEED : 88|14@1- (0.01,0) [0|16383] "" XXX
 SG_ NEW_SIGNAL_4 : 103|2@0+ (1,0) [0|3] "" XXX
 SG_ LAT_DIST_ACCEL : 104|13@1- (1,0) [0|8191] "" XXX
 SG_ REL_ACCEL : 118|10@1- (0.02,0) [0|1023] "" XXX
 SG_ NEW_SIGNAL_5 : 133|4@0+ (1,0) [0|15] "" XXX
 SG_ NEW_SIGNAL_1_2 : 153|2@0+ (1,0) [0|3] "" XXX
 SG_ NEW_SIGNAL_3_2 : 156|2@0+ (1,0) [0|3] "" XXX
 SG_ NEW_SIGNAL_2_2 : 166|7@0- (1,0) [0|127] "" XXX
 SG_ COUNTER_256_2 : 175|8@0+ (1,0) [0|255] "" XXX
 SG_ NEW_SIGNAL_6_2 : 179|4@0+ (1,0) [0|15] "" XXX
 SG_ STATE_2 : 182|3@0+ (1,0) [0|7] "" XXX
 SG_ NEW_SIGNAL_8_2 : 190|7@0- (1,0) [0|127] "" XXX
 SG_ LONG_DIST_2 : 191|13@1+ (0.05,0) [0|8191] "m" XXX
 SG_ LAT_DIST_2 : 204|12@1- (0.05,0) [0|127] "" XXX
 SG_ REL_SPEED_2 : 216|14@1- (0.01,0) [0|16383] "" XXX
 SG_ NEW_SIGNAL_4_2 : 231|2@0+ (1,0) [0|3] "" XXX
 SG_ LAT_DIST_ACCEL_2 : 232|13@1- (1,0) [0|8191] "" XXX
 SG_ REL_ACCEL_2 : 246|10@1- (0.02,0) [0|1023] "" XXX

BO_ 536 RADAR_TRACK_218: 32 RADAR
 SG_ CHECKSUM : 0|16@1+ (1,0) [0|65535] "" XXX
 SG_ COUNTER : 16|8@1+ (1,0) [0|255] "" XXX
 SG_ NEW_SIGNAL_1 : 25|2@0+ (1,0) [0|3] "" XXX
 SG_ NEW_SIGNAL_3 : 28|2@0+ (1,0) [0|3] "" XXX
 SG_ COUNTER_3 : 31|2@0+ (1,0) [0|3] "" XXX
 SG_ NEW_SIGNAL_2 : 38|7@0- (1,0) [0|127] "" XXX
 SG_ COUNTER_256 : 47|8@0+ (1,0) [0|255] "" XXX
 SG_ NEW_SIGNAL_6 : 51|4@0+ (1,0) [0|15] "" XXX
 SG_ STATE : 54|3@0+ (1,0) [0|7] "" XXX
 SG_ NEW_SIGNAL_8 : 62|7@0- (1,0) [0|127] "" XXX
 SG_ LONG_DIST : 63|13@1+ (0.05,0) [0|8191] "m" XXX
 SG_ LAT_DIST : 76|12@1- (0.05,0) [0|127] "" XXX
 SG_ REL_SPEED : 88|14@1- (0.01,0) [0|16383] "" XXX
 SG_ NEW_SIGNAL_4 : 103|2@0+ (1,0) [0|3] "" XXX
 SG_ LAT_DIST_ACCEL : 104|13@1- (1,0) [0|8191] "" XXX
 SG_ REL_ACCEL : 118|10@1- (0.02,0) [0|1023] "" XXX
 SG_ NEW_SIGNAL_5 : 133|4@0+ (1,0) [0|15] "" XXX
 SG_ NEW_SIGNAL_1_2 : 153|2@0+ (1,0) [0|3] "" XXX
 SG_ NEW_SIGNAL_3_2 : 156|2@0+ (1,0) [0|3] "" XXX
 SG_ NEW_SIGNAL_2_2 : 166|7@0- (1,0) [0|127] "" XXX
 SG_ COUNTER_256_2 : 175|8@0+ (1,0) [0|255] "" XXX
 SG_ NEW_SIGNAL_6_2 : 179|4@0+ (1,0) [0|15] "" XXX
 SG_ STATE_2 : 182|3@0+ (1,0) [0|7] "" XXX
 SG_ NEW_SIGNAL_8_2 : 190|7@0- (1,0) [0|127] "" XXX
 SG_ LONG_DIST_2 : 191|13@1+ (0.05,0) [0|8191] "m" XXX
 SG_ LAT_DIST_2 : 204|12@1- (0.05,0) [0|127] "" XXX
 SG_ REL_SPEED_2 : 216|14@1- (0.01,0) [0|16383] "" XXX
 SG_ NEW_SIGNAL_4_2 : 231|2@0+ (1,0) [0|3] "" XXX
 SG_ LAT_DIST_ACCEL_2 : 232|13@1- (1,0) [0|8191] "" XXX
 SG_ REL_ACCEL_2 : 246|10@1- (0.02,0) [0|1023] "" XXX

BO_ 537 RADAR_TRACK_219: 32 RADAR
 SG_ CHECKSUM : 0|16@1+ (1,0) [0|65535] "" XXX
 SG_ COUNTER : 16|8@1+ (1,0) [0|255] "" XXX
 SG_ NEW_SIGNAL_1 : 25|2@0+ (1,0) [0|3] "" XXX
 SG_ NEW_SIGNAL_3 : 28|2@0+ (1,0) [0|3] "" XXX
 SG_ COUNTER_3 : 31|2@0+ (1,0) [0|3] "" XXX
 SG_ NEW_SIGNAL_2 : 38|7@0- (1,0) [0|127] "" XXX
 SG_ COUNTER_256 : 47|8@0+ (1,0) [0|255] "" XXX
 SG_ NEW_SIGNAL_6 : 51|4@0+ (1,0) [0|15] "" XXX
 SG_ STATE : 54|3@0+ (1,0) [0|7] "" XXX
 SG_ NEW_SIGNAL_8 : 62|7@0- (1,0) [0|127] "" XXX
 SG_ LONG_DIST : 63|13@1+ (0.05,0) [0|8191] "m" XXX
 SG_ LAT_DIST : 76|12@1- (0.05,0) [0|127] "" XXX
 SG_ REL_SPEED : 88|14@1- (0.01,0) [0|16383] "" XXX
 SG_ NEW_SIGNAL_4 : 103|2@0+ (1,0) [0|3] "" XXX
 SG_ LAT_DIST_ACCEL : 104|13@1- (1,0) [0|8191] "" XXX
 SG_ REL_ACCEL : 118|10@1- (0.02,0) [0|1023] "" XXX
 SG_ NEW_SIGNAL_5 : 133|4@0+ (1,0) [0|15] "" XXX
 SG_ NEW_SIGNAL_1_2 : 153|2@0+ (1,0) [0|3] "" XXX
 SG_ NEW_SIGNAL_3_2 : 156|2@0+ (1,0) [0|3] "" XXX
 SG_ NEW_SIGNAL_2_2 : 166|7@0- (1,0) [0|127] "" XXX
 SG_ COUNTER_256_2 : 175|8@0+ (1,0) [0|255] "" XXX
 SG_ NEW_SIGNAL_6_2 : 179|4@0+ (1,0) [0|15] "" XXX
 SG_ STATE_2 : 182|3@0+ (1,0) [0|7] "" XXX
 SG_ NEW_SIGNAL_8_2 : 190|7@0- (1,0) [0|127] "" XXX
 SG_ LONG_DIST_2 : 191|13@1+ (0.05,0) [0|8191] "m" XXX
 SG_ LAT_DIST_2 : 204|12@1- (0.05,0) [0|127] "" XXX
 SG_ REL_SPEED_2 : 216|14@1- (0.01,0) [0|16383] "" XXX
 SG_ NEW_SIGNAL_4_2 : 231|2@0+ (1,0) [0|3] "" XXX
 SG_ LAT_DIST_ACCEL_2 : 232|13@1- (1,0) [0|8191] "" XXX
 SG_ REL_ACCEL_2 : 246|10@1- (0.02,0) [0|1023] "" XXX

BO_ 538 RADAR_TRACK_21a: 32 RADAR
 SG_ CHECKSUM : 0|16@1+ (1,0) [0|65535] "" XXX
 SG_ COUNTER : 16|8@1+ (1,0) [0|255] "" XXX
 SG_ NEW_SIGNAL_1 : 25|2@0+ (1,0) [0|3] "" XXX
 SG_ NEW_SIGNAL_3 : 28|2@0+ (1,0) [0|3] "" XXX
 SG_ COUNTER_3 : 31|2@0+ (1,0) [0|3] "" XXX
 SG_ NEW_SIGNAL_2 : 38|7@0- (1,0) [0|127] "" XXX
 SG_ COUNTER_256 : 47|8@0+ (1,0) [0|255] "" XXX
 SG_ NEW_SIGNAL_6 : 51|4@0+ (1,0) [0|15] "" XXX
 SG_ STATE : 54|3@0+ (1,0) [0|7] "" XXX
 SG_ NEW_SIGNAL_8 : 62|7@0- (1,0) [0|127] "" XXX
 SG_ LONG_DIST : 63|13@1+ (0.05,0) [0|8191] "m" XXX
 SG_ LAT_DIST : 76|12@1- (0.05,0) [0|127] "" XXX
 SG_ REL_SPEED : 88|14@1- (0.01,0) [0|16383] "" XXX
 SG_ NEW_SIGNAL_4 : 103|2@0+ (1,0) [0|3] "" XXX
 SG_ LAT_DIST_ACCEL : 104|13@1- (1,0) [0|8191] "" XXX
 SG_ REL_ACCEL : 118|10@1- (0.02,0) [0|1023] "" XXX
 SG_ NEW_SIGNAL_5 : 133|4@0+ (1,0) [0|15] "" XXX
 SG_ NEW_SIGNAL_1_2 : 153|2@0+ (1,0) [0|3] "" XXX
 SG_ NEW_SIGNAL_3_2 : 156|2@0+ (1,0) [0|3] "" XXX
 SG_ NEW_SIGNAL_2_2 : 166|7@0- (1,0) [0|127] "" XXX
 SG_ COUNTER_256_2 : 175|8@0+ (1,0) [0|255] "" XXX
 SG_ NEW_SIGNAL_6_2 : 179|4@0+ (1,0) [0|15] "" XXX
 SG_ STATE_2 : 182|3@0+ (1,0) [0|7] "" XXX
 SG_ NEW_SIGNAL_8_2 : 190|7@0- (1,0) [0|127] "" XXX
 SG_ LONG_DIST_2 : 191|13@1+ (0.05,0) [0|8191] "m" XXX
 SG_ LAT_DIST_2 : 204|12@1- (0.05,0) [0|127] "" XXX
 SG_ REL_SPEED_2 : 216|14@1- (0.01,0) [0|16383] "" XXX
 SG_ NEW_SIGNAL_4_2 : 231|2@0+ (1,0) [0|3] "" XXX
 SG_ LAT_DIST_ACCEL_2 : 232|13@1- (1,0) [0|8191] "" XXX
 SG_ REL_ACCEL_2 : 246|10@1- (0.02,0) [0|1023] "" XXX

BO_ 539 RADAR_TRACK_21b: 32 RADAR
 SG_ CHECKSUM : 0|16@1+ (1,0) [0|65535] "" XXX
 SG_ COUNTER : 16|8@1+ (1,0) [0|255] "" XXX
 SG_ NEW_SIGNAL_1 : 25|2@0+ (1,0) [0|3] "" XXX
 SG_ NEW_SIGNAL_3 : 28|2@0+ (1,0) [0|3] "" XXX
 SG_ COUNTER_3 : 31|2@0+ (1,0) [0|3] "" XXX
 SG_ NEW_SIGNAL_2 : 38|7@0- (1,0) [0|127] "" XXX
 SG_ COUNTER_256 : 47|8@0+ (1,0) [0|255] "" XXX
 SG_ NEW_SIGNAL_6 : 51|4@0+ (1,0) [0|15] "" XXX
 SG_ STATE : 54|3@0+ (1,0) [0|7] "" XXX
 SG_ NEW_SIGNAL_8 : 62|7@0- (1,0) [0|127] "" XXX
 SG_ LONG_DIST : 63|13@1+ (0.05,0) [0|8191] "m" XXX
 SG_ LAT_DIST : 76|12@1- (0.05,0) [0|127] "" XXX
 SG_ REL_SPEED : 88|14@1- (0.01,0) [0|16383] "" XXX
 SG_ NEW_SIGNAL_4 : 103|2@0+ (1,0) [0|3] "" XXX
 SG_ LAT_DIST_ACCEL : 104|13@1- (1,0) [0|8191] "" XXX
 SG_ REL_ACCEL : 118|10@1- (0.02,0) [0|1023] "" XXX
 SG_ NEW_SIGNAL_5 : 133|4@0+ (1,0) [0|15] "" XXX
 SG_ NEW_SIGNAL_1_2 : 153|2@0+ (1,0) [0|3] "" XXX
 SG_ NEW_SIGNAL_3_2 : 156|2@0+ (1,0) [0|3] "" XXX
 SG_ NEW_SIGNAL_2_2 : 166|7@0- (1,0) [0|127] "" XXX
 SG_ COUNTER_256_2 : 175|8@0+ (1,0) [0|255] "" XXX
 SG_ NEW_SIGNAL_6_2 : 179|4@0+ (1,0) [0|15] "" XXX
 SG_ STATE_2 : 182|3@0+ (1,0) [0|7] "" XXX
 SG_ NEW_SIGNAL_8_2 : 190|7@0- (1,0) [0|127] "" XXX
 SG_ LONG_DIST_2 : 191|13@1+ (0.05,0) [0|8191] "m" XXX
 SG_ LAT_DIST_2 : 204|12@1- (0.05,0) [0|127] "" XXX
 SG_ REL_SPEED_2 : 216|14@1- (0.01,0) [0|16383] "" XXX
 SG_ NEW_SIGNAL_4_2 : 231|2@0+ (1,0) [0|3] "" XXX
 SG_ LAT_DIST_ACCEL_2 : 232|13@1- (1,0) [0|8191] "" XXX
 SG_ REL_ACCEL_2 : 246|10@1- (0.02,0) [0|1023] "" XXX

BO_ 540 RADAR_TRACK_21c: 32 RADAR
 SG_ CHECKSUM : 0|16@1+ (1,0) [0|65535] "" XXX
 SG_ COUNTER : 16|8@1+ (1,0) [0|255] "" XXX
 SG_ NEW_SIGNAL_1 : 25|2@0+ (1,0) [0|3] "" XXX
 SG_ NEW_SIGNAL_3 : 28|2@0+ (1,0) [0|3] "" XXX
 SG_ COUNTER_3 : 31|2@0+ (1,0) [0|3] "" XXX
 SG_ NEW_SIGNAL_2 : 38|7@0- (1,0) [0|127] "" XXX
 SG_ COUNTER_256 : 47|8@0+ (1,0) [0|255] "" XXX
 SG_ NEW_SIGNAL_6 : 51|4@0+ (1,0) [0|15] "" XXX
 SG_ STATE : 54|3@0+ (1,0) [0|7] "" XXX
 SG_ NEW_SIGNAL_8 : 62|7@0- (1,0) [0|127] "" XXX
 SG_ LONG_DIST : 63|13@1+ (0.05,0) [0|8191] "m" XXX
 SG_ LAT_DIST : 76|12@1- (0.05,0) [0|127] "" XXX
 SG_ REL_SPEED : 88|14@1- (0.01,0) [0|16383] "" XXX
 SG_ NEW_SIGNAL_4 : 103|2@0+ (1,0) [0|3] "" XXX
 SG_ LAT_DIST_ACCEL : 104|13@1- (1,0) [0|8191] "" XXX
 SG_ REL_ACCEL : 118|10@1- (0.02,0) [0|1023] "" XXX
 SG_ NEW_SIGNAL_5 : 133|4@0+ (1,0) [0|15] "" XXX
 SG_ NEW_SIGNAL_1_2 : 153|2@0+ (1,0) [0|3] "" XXX
 SG_ NEW_SIGNAL_3_2 : 156|2@0+ (1,0) [0|3] "" XXX
 SG_ NEW_SIGNAL_2_2 : 166|7@0- (1,0) [0|127] "" XXX
 SG_ COUNTER_256_2 : 175|8@0+ (1,0) [0|255] "" XXX
 SG_ NEW_SIGNAL_6_2 : 179|4@0+ (1,0) [0|15] "" XXX
 SG_ STATE_2 : 182|3@0+ (1,0) [0|7] "" XXX
 SG_ NEW_SIGNAL_8_2 : 190|7@0- (1,0) [0|127] "" XXX
 SG_ LONG_DIST_2 : 191|13@1+ (0.05,0) [0|8191] "m" XXX
 SG_ LAT_DIST_2 : 204|12@1- (0.05,0) [0|127] "" XXX
 SG_ REL_SPEED_2 : 216|14@1- (0.01,0) [0|16383] "" XXX
 SG_ NEW_SIGNAL_4_2 : 231|2@0+ (1,0) [0|3] "" XXX
 SG_ LAT_DIST_ACCEL_2 : 232|13@1- (1,0) [0|8191] "" XXX
 SG_ REL_ACCEL_2 : 246|10@1- (0.02,0) [0|1023] "" XXX

BO_ 541 RADAR_TRACK_21d: 32 RADAR
 SG_ CHECKSUM : 0|16@1+ (1,0) [0|65535] "" XXX
 SG_ COUNTER : 16|8@1+ (1,0) [0|255] "" XXX
 SG_ NEW_SIGNAL_1 : 25|2@0+ (1,0) [0|3] "" XXX
 SG_ NEW_SIGNAL_3 : 28|2@0+ (1,0) [0|3] "" XXX
 SG_ COUNTER_3 : 31|2@0+ (1,0) [0|3] "" XXX
 SG_ NEW_SIGNAL_2 : 38|7@0- (1,0) [0|127] "" XXX
 SG_ COUNTER_256 : 47|8@0+ (1,0) [0|255] "" XXX
 SG_ NEW_SIGNAL_6 : 51|4@0+ (1,0) [0|15] "" XXX
 SG_ STATE : 54|3@0+ (1,0) [0|7] "" XXX
 SG_ NEW_SIGNAL_8 : 62|7@0- (1,0) [0|127] "" XXX
 SG_ LONG_DIST : 63|13@1+ (0.05,0) [0|8191] "m" XXX
 SG_ LAT_DIST : 76|12@1- (0.05,0) [0|127] "" XXX
 SG_ REL_SPEED : 88|14@1- (0.01,0) [0|16383] "" XXX
 SG_ NEW_SIGNAL_4 : 103|2@0+ (1,0) [0|3] "" XXX
 SG_ LAT_DIST_ACCEL : 104|13@1- (1,0) [0|8191] "" XXX
 SG_ REL_ACCEL : 118|10@1- (0.02,0) [0|1023] "" XXX
 SG_ NEW_SIGNAL_5 : 133|4@0+ (1,0) [0|15] "" XXX
 SG_ NEW_SIGNAL_1_2 : 153|2@0+ (1,0) [0|3] "" XXX
 SG_ NEW_SIGNAL_3_2 : 156|2@0+ (1,0) [0|3] "" XXX
 SG_ NEW_SIGNAL_2_2 : 166|7@0- (1,0) [0|127] "" XXX
 SG_ COUNTER_256_2 : 175|8@0+ (1,0) [0|255] "" XXX
 SG_ NEW_SIGNAL_6_2 : 179|4@0+ (1,0) [0|15] "" XXX
 SG_ STATE_2 : 182|3@0+ (1,0) [0|7] "" XXX
 SG_ NEW_SIGNAL_8_2 : 190|7@0- (1,0) [0|127] "" XXX
 SG_ LONG_DIST_2 : 191|13@1+ (0.05,0) [0|8191] "m" XXX
 SG_ LAT_DIST_2 : 204|12@1- (0.05,0) [0|127] "" XXX
 SG_ REL_SPEED_2 : 216|14@1- (0.01,0) [0|16383] "" XXX
 SG_ NEW_SIGNAL_4_2 : 231|2@0+ (1,0) [0|3] "" XXX
 SG_ LAT_DIST_ACCEL_2 : 232|13@1- (1,0) [0|8191] "" XXX
 SG_ REL_ACCEL_2 : 246|10@1- (0.02,0) [0|1023] "" XXX

BO_ 542 RADAR_TRACK_21e: 32 RADAR
 SG_ CHECKSUM : 0|16@1+ (1,0) [0|65535] "" XXX
 SG_ COUNTER : 16|8@1+ (1,0) [0|255] "" XXX
 SG_ NEW_SIGNAL_1 : 25|2@0+ (1,0) [0|3] "" XXX
 SG_ NEW_SIGNAL_3 : 28|2@0+ (1,0) [0|3] "" XXX
 SG_ COUNTER_3 : 31|2@0+ (1,0) [0|3] "" XXX
 SG_ NEW_SIGNAL_2 : 38|7@0- (1,0) [0|127] "" XXX
 SG_ COUNTER_256 : 47|8@0+ (1,0) [0|255] "" XXX
 SG_ NEW_SIGNAL_6 : 51|4@0+ (1,0) [0|15] "" XXX
 SG_ STATE : 54|3@0+ (1,0) [0|7] "" XXX
 SG_ NEW_SIGNAL_8 : 62|7@0- (1,0) [0|127] "" XXX
 SG_ LONG_DIST : 63|13@1+ (0.05,0) [0|8191] "m" XXX
 SG_ LAT_DIST : 76|12@1- (0.05,0) [0|127] "" XXX
 SG_ REL_SPEED : 88|14@1- (0.01,0) [0|16383] "" XXX
 SG_ NEW_SIGNAL_4 : 103|2@0+ (1,0) [0|3] "" XXX
 SG_ LAT_DIST_ACCEL : 104|13@1- (1,0) [0|8191] "" XXX
 SG_ REL_ACCEL : 118|10@1- (0.02,0) [0|1023] "" XXX
 SG_ NEW_SIGNAL_5 : 133|4@0+ (1,0) [0|15] "" XXX
 SG_ NEW_SIGNAL_1_2 : 153|2@0+ (1,0) [0|3] "" XXX
 SG_ NEW_SIGNAL_3_2 : 156|2@0+ (1,0) [0|3] "" XXX
 SG_ NEW_SIGNAL_2_2 : 166|7@0- (1,0) [0|127] "" XXX
 SG_ COUNTER_256_2 : 175|8@0+ (1,0) [0|255] "" XXX
 SG_ NEW_SIGNAL_6_2 : 179|4@0+ (1,0) [0|15] "" XXX
 SG_ STATE_2 : 182|3@0+ (1,0) [0|7] "" XXX
 SG_ NEW_SIGNAL_8_2 : 190|7@0- (1,0) [0|127] "" XXX
 SG_ LONG_DIST_2 : 191|13@1+ (0.05,0) [0|8191] "m" XXX
 SG_ LAT_DIST_2 : 204|12@1- (0.05,0) [0|127] "" XXX
 SG_ REL_SPEED_2 : 216|14@1- (0.01,0) [0|16383] "" XXX
 SG_ NEW_SIGNAL_4_2 : 231|2@0+ (1,0) [0|3] "" XXX
 SG_ LAT_DIST_ACCEL_2 : 232|13@1- (1,0) [0|8191] "" XXX
 SG_ REL_ACCEL_2 : 246|10@1- (0.02,0) [0|1023] "" XXX

BO_ 543 RADAR_TRACK_21f: 32 RADAR
 SG_ CHECKSUM : 0|16@1+ (1,0) [0|65535] "" XXX
 SG_ COUNTER : 16|8@1+ (1,0) [0|255] "" XXX
 SG_ NEW_SIGNAL_1 : 25|2@0+ (1,0) [0|3] "" XXX
 SG_ NEW_SIGNAL_3 : 28|2@0+ (1,0) [0|3] "" XXX
 SG_ COUNTER_3 : 31|2@0+ (1,0) [0|3] "" XXX
 SG_ NEW_SIGNAL_2 : 38|7@0- (1,0) [0|127] "" XXX
 SG_ COUNTER_256 : 47|8@0+ (1,0) [0|255] "" XXX
 SG_ NEW_SIGNAL_6 : 51|4@0+ (1,0) [0|15] "" XXX
 SG_ STATE : 54|3@0+ (1,0) [0|7] "" XXX
 SG_ NEW_SIGNAL_8 : 62|7@0- (1,0) [0|127] "" XXX
 SG_ LONG_DIST : 63|13@1+ (0.05,0) [0|8191] "m" XXX
 SG_ LAT_DIST : 76|12@1- (0.05,0) [0|127] "" XXX
 SG_ REL_SPEED : 88|14@1- (0.01,0) [0|16383] "" XXX
 SG_ NEW_SIGNAL_4 : 103|2@0+ (1,0) [0|3] "" XXX
 SG_ LAT_DIST_ACCEL : 104|13@1- (1,0) [0|8191] "" XXX
 SG_ REL_ACCEL : 118|10@1- (0.02,0) [0|1023] "" XXX
 SG_ NEW_SIGNAL_5 : 133|4@0+ (1,0) [0|15] "" XXX
 SG_ NEW_SIGNAL_1_2 : 153|2@0+ (1,0) [0|3] "" XXX
 SG_ NEW_SIGNAL_3_2 : 156|2@0+ (1,0) [0|3] "" XXX
 SG_ NEW_SIGNAL_2_2 : 166|7@0- (1,0) [0|127] "" XXX
 SG_ COUNTER_256_2 : 175|8@0+ (1,0) [0|255] "" XXX
 SG_ NEW_SIGNAL_6_2 : 179|4@0+ (1,0) [0|15] "" XXX
 SG_ STATE_2 : 182|3@0+ (1,0) [0|7] "" XXX
 SG_ NEW_SIGNAL_8_2 : 190|7@0- (1,0) [0|127] "" XXX
 SG_ LONG_DIST_2 : 191|13@1+ (0.05,0) [0|8191] "m" XXX
 SG_ LAT_DIST_2 : 204|12@1- (0.05,0) [0|127] "" XXX
 SG_ REL_SPEED_2 : 216|14@1- (0.01,0) [0|16383] "" XXX
 SG_ NEW_SIGNAL_4_2 : 231|2@0+ (1,0) [0|3] "" XXX
 SG_ LAT_DIST_ACCEL_2 : 232|13@1- (1,0) [0|8191] "" XXX
 SG_ REL_ACCEL_2 : 246|10@1- (0.02,0) [0|1023] "" XXX
