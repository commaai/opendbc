VERSION ""

NS_ :

BS_:

BU_: XXX

BO_ 933 RADAR_TRACK_3A5: 24 RADAR
 SG_ CHECKSUM : 0|16@1+ (1,0) [0|65535] "" XXX
 SG_ COUNTER : 16|8@1+ (1,0) [0|255] "" XXX
 SG_ NEW_SIGNAL_1 : 25|2@0+ (1,0) [0|3] "" XXX
 SG_ NEW_SIGNAL_3 : 28|2@0+ (1,0) [0|3] "" XXX
 SG_ COUNTER_3 : 31|2@0+ (1,0) [0|3] "" XXX
 SG_ NEW_SIGNAL_2 : 38|7@0- (1,0) [0|127] "" XXX
 SG_ COUNTER_256 : 47|8@0+ (1,0) [0|255] "" XXX
 SG_ NEW_SIGNAL_6 : 51|4@0+ (1,0) [0|15] "" XXX
 SG_ STATE : 54|3@0+ (1,0) [0|7] "" XXX
 SG_ NEW_SIGNAL_8 : 62|7@0- (1,0) [0|127] "" XXX
 SG_ LONG_DIST : 63|12@1+ (0.1,0) [0|8191] "" XXX
 SG_ AZIMUTH : 76|12@1- (0.2,0) [0|127] "" XXX
 SG_ REL_SPEED : 88|14@1- (0.01,0) [0|16383] "" XXX
 SG_ NEW_SIGNAL_4 : 103|2@0+ (1,0) [0|3] "" XXX
 SG_ AZIMUTH_ACCEL : 104|13@1- (1,0) [0|8191] "" XXX
 SG_ REL_ACCEL : 118|10@1- (0.02,0) [0|1023] "" XXX
 SG_ NEW_SIGNAL_5 : 133|4@0+ (1,0) [0|15] "" XXX

BO_ 934 RADAR_TRACK_3A6: 24 RADAR
 SG_ CHECKSUM : 0|16@1+ (1,0) [0|65535] "" XXX
 SG_ COUNTER : 16|8@1+ (1,0) [0|255] "" XXX
 SG_ NEW_SIGNAL_1 : 25|2@0+ (1,0) [0|3] "" XXX
 SG_ NEW_SIGNAL_3 : 28|2@0+ (1,0) [0|3] "" XXX
 SG_ COUNTER_3 : 31|2@0+ (1,0) [0|3] "" XXX
 SG_ NEW_SIGNAL_2 : 38|7@0- (1,0) [0|127] "" XXX
 SG_ COUNTER_256 : 47|8@0+ (1,0) [0|255] "" XXX
 SG_ NEW_SIGNAL_6 : 51|4@0+ (1,0) [0|15] "" XXX
 SG_ STATE : 54|3@0+ (1,0) [0|7] "" XXX
 SG_ NEW_SIGNAL_8 : 62|7@0- (1,0) [0|127] "" XXX
 SG_ LONG_DIST : 63|12@1+ (0.1,0) [0|8191] "" XXX
 SG_ AZIMUTH : 76|12@1- (0.2,0) [0|127] "" XXX
 SG_ REL_SPEED : 88|14@1- (0.01,0) [0|16383] "" XXX
 SG_ NEW_SIGNAL_4 : 103|2@0+ (1,0) [0|3] "" XXX
 SG_ AZIMUTH_ACCEL : 104|13@1- (1,0) [0|8191] "" XXX
 SG_ REL_ACCEL : 118|10@1- (0.02,0) [0|1023] "" XXX
 SG_ NEW_SIGNAL_5 : 133|4@0+ (1,0) [0|15] "" XXX

BO_ 935 RADAR_TRACK_3A7: 24 RADAR
 SG_ CHECKSUM : 0|16@1+ (1,0) [0|65535] "" XXX
 SG_ COUNTER : 16|8@1+ (1,0) [0|255] "" XXX
 SG_ NEW_SIGNAL_1 : 25|2@0+ (1,0) [0|3] "" XXX
 SG_ NEW_SIGNAL_3 : 28|2@0+ (1,0) [0|3] "" XXX
 SG_ COUNTER_3 : 31|2@0+ (1,0) [0|3] "" XXX
 SG_ NEW_SIGNAL_2 : 38|7@0- (1,0) [0|127] "" XXX
 SG_ COUNTER_256 : 47|8@0+ (1,0) [0|255] "" XXX
 SG_ NEW_SIGNAL_6 : 51|4@0+ (1,0) [0|15] "" XXX
 SG_ STATE : 54|3@0+ (1,0) [0|7] "" XXX
 SG_ NEW_SIGNAL_8 : 62|7@0- (1,0) [0|127] "" XXX
 SG_ LONG_DIST : 63|12@1+ (0.1,0) [0|8191] "" XXX
 SG_ AZIMUTH : 76|12@1- (0.2,0) [0|127] "" XXX
 SG_ REL_SPEED : 88|14@1- (0.01,0) [0|16383] "" XXX
 SG_ NEW_SIGNAL_4 : 103|2@0+ (1,0) [0|3] "" XXX
 SG_ AZIMUTH_ACCEL : 104|13@1- (1,0) [0|8191] "" XXX
 SG_ REL_ACCEL : 118|10@1- (0.02,0) [0|1023] "" XXX
 SG_ NEW_SIGNAL_5 : 133|4@0+ (1,0) [0|15] "" XXX

BO_ 936 RADAR_TRACK_3A8: 24 RADAR
 SG_ CHECKSUM : 0|16@1+ (1,0) [0|65535] "" XXX
 SG_ COUNTER : 16|8@1+ (1,0) [0|255] "" XXX
 SG_ NEW_SIGNAL_1 : 25|2@0+ (1,0) [0|3] "" XXX
 SG_ NEW_SIGNAL_3 : 28|2@0+ (1,0) [0|3] "" XXX
 SG_ COUNTER_3 : 31|2@0+ (1,0) [0|3] "" XXX
 SG_ NEW_SIGNAL_2 : 38|7@0- (1,0) [0|127] "" XXX
 SG_ COUNTER_256 : 47|8@0+ (1,0) [0|255] "" XXX
 SG_ NEW_SIGNAL_6 : 51|4@0+ (1,0) [0|15] "" XXX
 SG_ STATE : 54|3@0+ (1,0) [0|7] "" XXX
 SG_ NEW_SIGNAL_8 : 62|7@0- (1,0) [0|127] "" XXX
 SG_ LONG_DIST : 63|12@1+ (0.1,0) [0|8191] "" XXX
 SG_ AZIMUTH : 76|12@1- (0.2,0) [0|127] "" XXX
 SG_ REL_SPEED : 88|14@1- (0.01,0) [0|16383] "" XXX
 SG_ NEW_SIGNAL_4 : 103|2@0+ (1,0) [0|3] "" XXX
 SG_ AZIMUTH_ACCEL : 104|13@1- (1,0) [0|8191] "" XXX
 SG_ REL_ACCEL : 118|10@1- (0.02,0) [0|1023] "" XXX
 SG_ NEW_SIGNAL_5 : 133|4@0+ (1,0) [0|15] "" XXX

BO_ 937 RADAR_TRACK_3A9: 24 RADAR
 SG_ CHECKSUM : 0|16@1+ (1,0) [0|65535] "" XXX
 SG_ COUNTER : 16|8@1+ (1,0) [0|255] "" XXX
 SG_ NEW_SIGNAL_1 : 25|2@0+ (1,0) [0|3] "" XXX
 SG_ NEW_SIGNAL_3 : 28|2@0+ (1,0) [0|3] "" XXX
 SG_ COUNTER_3 : 31|2@0+ (1,0) [0|3] "" XXX
 SG_ NEW_SIGNAL_2 : 38|7@0- (1,0) [0|127] "" XXX
 SG_ COUNTER_256 : 47|8@0+ (1,0) [0|255] "" XXX
 SG_ NEW_SIGNAL_6 : 51|4@0+ (1,0) [0|15] "" XXX
 SG_ STATE : 54|3@0+ (1,0) [0|7] "" XXX
 SG_ NEW_SIGNAL_8 : 62|7@0- (1,0) [0|127] "" XXX
 SG_ LONG_DIST : 63|12@1+ (0.1,0) [0|8191] "" XXX
 SG_ AZIMUTH : 76|12@1- (0.2,0) [0|127] "" XXX
 SG_ REL_SPEED : 88|14@1- (0.01,0) [0|16383] "" XXX
 SG_ NEW_SIGNAL_4 : 103|2@0+ (1,0) [0|3] "" XXX
 SG_ AZIMUTH_ACCEL : 104|13@1- (1,0) [0|8191] "" XXX
 SG_ REL_ACCEL : 118|10@1- (0.02,0) [0|1023] "" XXX
 SG_ NEW_SIGNAL_5 : 133|4@0+ (1,0) [0|15] "" XXX

BO_ 938 RADAR_TRACK_3AA: 24 RADAR
 SG_ CHECKSUM : 0|16@1+ (1,0) [0|65535] "" XXX
 SG_ COUNTER : 16|8@1+ (1,0) [0|255] "" XXX
 SG_ NEW_SIGNAL_1 : 25|2@0+ (1,0) [0|3] "" XXX
 SG_ NEW_SIGNAL_3 : 28|2@0+ (1,0) [0|3] "" XXX
 SG_ COUNTER_3 : 31|2@0+ (1,0) [0|3] "" XXX
 SG_ NEW_SIGNAL_2 : 38|7@0- (1,0) [0|127] "" XXX
 SG_ COUNTER_256 : 47|8@0+ (1,0) [0|255] "" XXX
 SG_ NEW_SIGNAL_6 : 51|4@0+ (1,0) [0|15] "" XXX
 SG_ STATE : 54|3@0+ (1,0) [0|7] "" XXX
 SG_ NEW_SIGNAL_8 : 62|7@0- (1,0) [0|127] "" XXX
 SG_ LONG_DIST : 63|12@1+ (0.1,0) [0|8191] "" XXX
 SG_ AZIMUTH : 76|12@1- (0.2,0) [0|127] "" XXX
 SG_ REL_SPEED : 88|14@1- (0.01,0) [0|16383] "" XXX
 SG_ NEW_SIGNAL_4 : 103|2@0+ (1,0) [0|3] "" XXX
 SG_ AZIMUTH_ACCEL : 104|13@1- (1,0) [0|8191] "" XXX
 SG_ REL_ACCEL : 118|10@1- (0.02,0) [0|1023] "" XXX
 SG_ NEW_SIGNAL_5 : 133|4@0+ (1,0) [0|15] "" XXX

BO_ 939 RADAR_TRACK_3AB: 24 RADAR
 SG_ CHECKSUM : 0|16@1+ (1,0) [0|65535] "" XXX
 SG_ COUNTER : 16|8@1+ (1,0) [0|255] "" XXX
 SG_ NEW_SIGNAL_1 : 25|2@0+ (1,0) [0|3] "" XXX
 SG_ NEW_SIGNAL_3 : 28|2@0+ (1,0) [0|3] "" XXX
 SG_ COUNTER_3 : 31|2@0+ (1,0) [0|3] "" XXX
 SG_ NEW_SIGNAL_2 : 38|7@0- (1,0) [0|127] "" XXX
 SG_ COUNTER_256 : 47|8@0+ (1,0) [0|255] "" XXX
 SG_ NEW_SIGNAL_6 : 51|4@0+ (1,0) [0|15] "" XXX
 SG_ STATE : 54|3@0+ (1,0) [0|7] "" XXX
 SG_ NEW_SIGNAL_8 : 62|7@0- (1,0) [0|127] "" XXX
 SG_ LONG_DIST : 63|12@1+ (0.1,0) [0|8191] "" XXX
 SG_ AZIMUTH : 76|12@1- (0.2,0) [0|127] "" XXX
 SG_ REL_SPEED : 88|14@1- (0.01,0) [0|16383] "" XXX
 SG_ NEW_SIGNAL_4 : 103|2@0+ (1,0) [0|3] "" XXX
 SG_ AZIMUTH_ACCEL : 104|13@1- (1,0) [0|8191] "" XXX
 SG_ REL_ACCEL : 118|10@1- (0.02,0) [0|1023] "" XXX
 SG_ NEW_SIGNAL_5 : 133|4@0+ (1,0) [0|15] "" XXX

BO_ 940 RADAR_TRACK_3AC: 24 RADAR
 SG_ CHECKSUM : 0|16@1+ (1,0) [0|65535] "" XXX
 SG_ COUNTER : 16|8@1+ (1,0) [0|255] "" XXX
 SG_ NEW_SIGNAL_1 : 25|2@0+ (1,0) [0|3] "" XXX
 SG_ NEW_SIGNAL_3 : 28|2@0+ (1,0) [0|3] "" XXX
 SG_ COUNTER_3 : 31|2@0+ (1,0) [0|3] "" XXX
 SG_ NEW_SIGNAL_2 : 38|7@0- (1,0) [0|127] "" XXX
 SG_ COUNTER_256 : 47|8@0+ (1,0) [0|255] "" XXX
 SG_ NEW_SIGNAL_6 : 51|4@0+ (1,0) [0|15] "" XXX
 SG_ STATE : 54|3@0+ (1,0) [0|7] "" XXX
 SG_ NEW_SIGNAL_8 : 62|7@0- (1,0) [0|127] "" XXX
 SG_ LONG_DIST : 63|12@1+ (0.1,0) [0|8191] "" XXX
 SG_ AZIMUTH : 76|12@1- (0.2,0) [0|127] "" XXX
 SG_ REL_SPEED : 88|14@1- (0.01,0) [0|16383] "" XXX
 SG_ NEW_SIGNAL_4 : 103|2@0+ (1,0) [0|3] "" XXX
 SG_ AZIMUTH_ACCEL : 104|13@1- (1,0) [0|8191] "" XXX
 SG_ REL_ACCEL : 118|10@1- (0.02,0) [0|1023] "" XXX
 SG_ NEW_SIGNAL_5 : 133|4@0+ (1,0) [0|15] "" XXX

BO_ 941 RADAR_TRACK_3AD: 24 RADAR
 SG_ CHECKSUM : 0|16@1+ (1,0) [0|65535] "" XXX
 SG_ COUNTER : 16|8@1+ (1,0) [0|255] "" XXX
 SG_ NEW_SIGNAL_1 : 25|2@0+ (1,0) [0|3] "" XXX
 SG_ NEW_SIGNAL_3 : 28|2@0+ (1,0) [0|3] "" XXX
 SG_ COUNTER_3 : 31|2@0+ (1,0) [0|3] "" XXX
 SG_ NEW_SIGNAL_2 : 38|7@0- (1,0) [0|127] "" XXX
 SG_ COUNTER_256 : 47|8@0+ (1,0) [0|255] "" XXX
 SG_ NEW_SIGNAL_6 : 51|4@0+ (1,0) [0|15] "" XXX
 SG_ STATE : 54|3@0+ (1,0) [0|7] "" XXX
 SG_ NEW_SIGNAL_8 : 62|7@0- (1,0) [0|127] "" XXX
 SG_ LONG_DIST : 63|12@1+ (0.1,0) [0|8191] "" XXX
 SG_ AZIMUTH : 76|12@1- (0.2,0) [0|127] "" XXX
 SG_ REL_SPEED : 88|14@1- (0.01,0) [0|16383] "" XXX
 SG_ NEW_SIGNAL_4 : 103|2@0+ (1,0) [0|3] "" XXX
 SG_ AZIMUTH_ACCEL : 104|13@1- (1,0) [0|8191] "" XXX
 SG_ REL_ACCEL : 118|10@1- (0.02,0) [0|1023] "" XXX
 SG_ NEW_SIGNAL_5 : 133|4@0+ (1,0) [0|15] "" XXX

BO_ 942 RADAR_TRACK_3AE: 24 RADAR
 SG_ CHECKSUM : 0|16@1+ (1,0) [0|65535] "" XXX
 SG_ COUNTER : 16|8@1+ (1,0) [0|255] "" XXX
 SG_ NEW_SIGNAL_1 : 25|2@0+ (1,0) [0|3] "" XXX
 SG_ NEW_SIGNAL_3 : 28|2@0+ (1,0) [0|3] "" XXX
 SG_ COUNTER_3 : 31|2@0+ (1,0) [0|3] "" XXX
 SG_ NEW_SIGNAL_2 : 38|7@0- (1,0) [0|127] "" XXX
 SG_ COUNTER_256 : 47|8@0+ (1,0) [0|255] "" XXX
 SG_ NEW_SIGNAL_6 : 51|4@0+ (1,0) [0|15] "" XXX
 SG_ STATE : 54|3@0+ (1,0) [0|7] "" XXX
 SG_ NEW_SIGNAL_8 : 62|7@0- (1,0) [0|127] "" XXX
 SG_ LONG_DIST : 63|12@1+ (0.1,0) [0|8191] "" XXX
 SG_ AZIMUTH : 76|12@1- (0.2,0) [0|127] "" XXX
 SG_ REL_SPEED : 88|14@1- (0.01,0) [0|16383] "" XXX
 SG_ NEW_SIGNAL_4 : 103|2@0+ (1,0) [0|3] "" XXX
 SG_ AZIMUTH_ACCEL : 104|13@1- (1,0) [0|8191] "" XXX
 SG_ REL_ACCEL : 118|10@1- (0.02,0) [0|1023] "" XXX
 SG_ NEW_SIGNAL_5 : 133|4@0+ (1,0) [0|15] "" XXX

BO_ 943 RADAR_TRACK_3AF: 24 RADAR
 SG_ CHECKSUM : 0|16@1+ (1,0) [0|65535] "" XXX
 SG_ COUNTER : 16|8@1+ (1,0) [0|255] "" XXX
 SG_ NEW_SIGNAL_1 : 25|2@0+ (1,0) [0|3] "" XXX
 SG_ NEW_SIGNAL_3 : 28|2@0+ (1,0) [0|3] "" XXX
 SG_ COUNTER_3 : 31|2@0+ (1,0) [0|3] "" XXX
 SG_ NEW_SIGNAL_2 : 38|7@0- (1,0) [0|127] "" XXX
 SG_ COUNTER_256 : 47|8@0+ (1,0) [0|255] "" XXX
 SG_ NEW_SIGNAL_6 : 51|4@0+ (1,0) [0|15] "" XXX
 SG_ STATE : 54|3@0+ (1,0) [0|7] "" XXX
 SG_ NEW_SIGNAL_8 : 62|7@0- (1,0) [0|127] "" XXX
 SG_ LONG_DIST : 63|12@1+ (0.1,0) [0|8191] "" XXX
 SG_ AZIMUTH : 76|12@1- (0.2,0) [0|127] "" XXX
 SG_ REL_SPEED : 88|14@1- (0.01,0) [0|16383] "" XXX
 SG_ NEW_SIGNAL_4 : 103|2@0+ (1,0) [0|3] "" XXX
 SG_ AZIMUTH_ACCEL : 104|13@1- (1,0) [0|8191] "" XXX
 SG_ REL_ACCEL : 118|10@1- (0.02,0) [0|1023] "" XXX
 SG_ NEW_SIGNAL_5 : 133|4@0+ (1,0) [0|15] "" XXX

BO_ 944 RADAR_TRACK_3B0: 24 RADAR
 SG_ CHECKSUM : 0|16@1+ (1,0) [0|65535] "" XXX
 SG_ COUNTER : 16|8@1+ (1,0) [0|255] "" XXX
 SG_ NEW_SIGNAL_1 : 25|2@0+ (1,0) [0|3] "" XXX
 SG_ NEW_SIGNAL_3 : 28|2@0+ (1,0) [0|3] "" XXX
 SG_ COUNTER_3 : 31|2@0+ (1,0) [0|3] "" XXX
 SG_ NEW_SIGNAL_2 : 38|7@0- (1,0) [0|127] "" XXX
 SG_ COUNTER_256 : 47|8@0+ (1,0) [0|255] "" XXX
 SG_ NEW_SIGNAL_6 : 51|4@0+ (1,0) [0|15] "" XXX
 SG_ STATE : 54|3@0+ (1,0) [0|7] "" XXX
 SG_ NEW_SIGNAL_8 : 62|7@0- (1,0) [0|127] "" XXX
 SG_ LONG_DIST : 63|12@1+ (0.1,0) [0|8191] "" XXX
 SG_ AZIMUTH : 76|12@1- (0.2,0) [0|127] "" XXX
 SG_ REL_SPEED : 88|14@1- (0.01,0) [0|16383] "" XXX
 SG_ NEW_SIGNAL_4 : 103|2@0+ (1,0) [0|3] "" XXX
 SG_ AZIMUTH_ACCEL : 104|13@1- (1,0) [0|8191] "" XXX
 SG_ REL_ACCEL : 118|10@1- (0.02,0) [0|1023] "" XXX
 SG_ NEW_SIGNAL_5 : 133|4@0+ (1,0) [0|15] "" XXX

BO_ 945 RADAR_TRACK_3B1: 24 RADAR
 SG_ CHECKSUM : 0|16@1+ (1,0) [0|65535] "" XXX
 SG_ COUNTER : 16|8@1+ (1,0) [0|255] "" XXX
 SG_ NEW_SIGNAL_1 : 25|2@0+ (1,0) [0|3] "" XXX
 SG_ NEW_SIGNAL_3 : 28|2@0+ (1,0) [0|3] "" XXX
 SG_ COUNTER_3 : 31|2@0+ (1,0) [0|3] "" XXX
 SG_ NEW_SIGNAL_2 : 38|7@0- (1,0) [0|127] "" XXX
 SG_ COUNTER_256 : 47|8@0+ (1,0) [0|255] "" XXX
 SG_ NEW_SIGNAL_6 : 51|4@0+ (1,0) [0|15] "" XXX
 SG_ STATE : 54|3@0+ (1,0) [0|7] "" XXX
 SG_ NEW_SIGNAL_8 : 62|7@0- (1,0) [0|127] "" XXX
 SG_ LONG_DIST : 63|12@1+ (0.1,0) [0|8191] "" XXX
 SG_ AZIMUTH : 76|12@1- (0.2,0) [0|127] "" XXX
 SG_ REL_SPEED : 88|14@1- (0.01,0) [0|16383] "" XXX
 SG_ NEW_SIGNAL_4 : 103|2@0+ (1,0) [0|3] "" XXX
 SG_ AZIMUTH_ACCEL : 104|13@1- (1,0) [0|8191] "" XXX
 SG_ REL_ACCEL : 118|10@1- (0.02,0) [0|1023] "" XXX
 SG_ NEW_SIGNAL_5 : 133|4@0+ (1,0) [0|15] "" XXX

BO_ 946 RADAR_TRACK_3B2: 24 RADAR
 SG_ CHECKSUM : 0|16@1+ (1,0) [0|65535] "" XXX
 SG_ COUNTER : 16|8@1+ (1,0) [0|255] "" XXX
 SG_ NEW_SIGNAL_1 : 25|2@0+ (1,0) [0|3] "" XXX
 SG_ NEW_SIGNAL_3 : 28|2@0+ (1,0) [0|3] "" XXX
 SG_ COUNTER_3 : 31|2@0+ (1,0) [0|3] "" XXX
 SG_ NEW_SIGNAL_2 : 38|7@0- (1,0) [0|127] "" XXX
 SG_ COUNTER_256 : 47|8@0+ (1,0) [0|255] "" XXX
 SG_ NEW_SIGNAL_6 : 51|4@0+ (1,0) [0|15] "" XXX
 SG_ STATE : 54|3@0+ (1,0) [0|7] "" XXX
 SG_ NEW_SIGNAL_8 : 62|7@0- (1,0) [0|127] "" XXX
 SG_ LONG_DIST : 63|12@1+ (0.1,0) [0|8191] "" XXX
 SG_ AZIMUTH : 76|12@1- (0.2,0) [0|127] "" XXX
 SG_ REL_SPEED : 88|14@1- (0.01,0) [0|16383] "" XXX
 SG_ NEW_SIGNAL_4 : 103|2@0+ (1,0) [0|3] "" XXX
 SG_ AZIMUTH_ACCEL : 104|13@1- (1,0) [0|8191] "" XXX
 SG_ REL_ACCEL : 118|10@1- (0.02,0) [0|1023] "" XXX
 SG_ NEW_SIGNAL_5 : 133|4@0+ (1,0) [0|15] "" XXX

BO_ 947 RADAR_TRACK_3B3: 24 RADAR
 SG_ CHECKSUM : 0|16@1+ (1,0) [0|65535] "" XXX
 SG_ COUNTER : 16|8@1+ (1,0) [0|255] "" XXX
 SG_ NEW_SIGNAL_1 : 25|2@0+ (1,0) [0|3] "" XXX
 SG_ NEW_SIGNAL_3 : 28|2@0+ (1,0) [0|3] "" XXX
 SG_ COUNTER_3 : 31|2@0+ (1,0) [0|3] "" XXX
 SG_ NEW_SIGNAL_2 : 38|7@0- (1,0) [0|127] "" XXX
 SG_ COUNTER_256 : 47|8@0+ (1,0) [0|255] "" XXX
 SG_ NEW_SIGNAL_6 : 51|4@0+ (1,0) [0|15] "" XXX
 SG_ STATE : 54|3@0+ (1,0) [0|7] "" XXX
 SG_ NEW_SIGNAL_8 : 62|7@0- (1,0) [0|127] "" XXX
 SG_ LONG_DIST : 63|12@1+ (0.1,0) [0|8191] "" XXX
 SG_ AZIMUTH : 76|12@1- (0.2,0) [0|127] "" XXX
 SG_ REL_SPEED : 88|14@1- (0.01,0) [0|16383] "" XXX
 SG_ NEW_SIGNAL_4 : 103|2@0+ (1,0) [0|3] "" XXX
 SG_ AZIMUTH_ACCEL : 104|13@1- (1,0) [0|8191] "" XXX
 SG_ REL_ACCEL : 118|10@1- (0.02,0) [0|1023] "" XXX
 SG_ NEW_SIGNAL_5 : 133|4@0+ (1,0) [0|15] "" XXX

BO_ 948 RADAR_TRACK_3B4: 24 RADAR
 SG_ CHECKSUM : 0|16@1+ (1,0) [0|65535] "" XXX
 SG_ COUNTER : 16|8@1+ (1,0) [0|255] "" XXX
 SG_ NEW_SIGNAL_1 : 25|2@0+ (1,0) [0|3] "" XXX
 SG_ NEW_SIGNAL_3 : 28|2@0+ (1,0) [0|3] "" XXX
 SG_ COUNTER_3 : 31|2@0+ (1,0) [0|3] "" XXX
 SG_ NEW_SIGNAL_2 : 38|7@0- (1,0) [0|127] "" XXX
 SG_ COUNTER_256 : 47|8@0+ (1,0) [0|255] "" XXX
 SG_ NEW_SIGNAL_6 : 51|4@0+ (1,0) [0|15] "" XXX
 SG_ STATE : 54|3@0+ (1,0) [0|7] "" XXX
 SG_ NEW_SIGNAL_8 : 62|7@0- (1,0) [0|127] "" XXX
 SG_ LONG_DIST : 63|12@1+ (0.1,0) [0|8191] "" XXX
 SG_ AZIMUTH : 76|12@1- (0.2,0) [0|127] "" XXX
 SG_ REL_SPEED : 88|14@1- (0.01,0) [0|16383] "" XXX
 SG_ NEW_SIGNAL_4 : 103|2@0+ (1,0) [0|3] "" XXX
 SG_ AZIMUTH_ACCEL : 104|13@1- (1,0) [0|8191] "" XXX
 SG_ REL_ACCEL : 118|10@1- (0.02,0) [0|1023] "" XXX
 SG_ NEW_SIGNAL_5 : 133|4@0+ (1,0) [0|15] "" XXX

BO_ 949 RADAR_TRACK_3B5: 24 RADAR
 SG_ CHECKSUM : 0|16@1+ (1,0) [0|65535] "" XXX
 SG_ COUNTER : 16|8@1+ (1,0) [0|255] "" XXX
 SG_ NEW_SIGNAL_1 : 25|2@0+ (1,0) [0|3] "" XXX
 SG_ NEW_SIGNAL_3 : 28|2@0+ (1,0) [0|3] "" XXX
 SG_ COUNTER_3 : 31|2@0+ (1,0) [0|3] "" XXX
 SG_ NEW_SIGNAL_2 : 38|7@0- (1,0) [0|127] "" XXX
 SG_ COUNTER_256 : 47|8@0+ (1,0) [0|255] "" XXX
 SG_ NEW_SIGNAL_6 : 51|4@0+ (1,0) [0|15] "" XXX
 SG_ STATE : 54|3@0+ (1,0) [0|7] "" XXX
 SG_ NEW_SIGNAL_8 : 62|7@0- (1,0) [0|127] "" XXX
 SG_ LONG_DIST : 63|12@1+ (0.1,0) [0|8191] "" XXX
 SG_ AZIMUTH : 76|12@1- (0.2,0) [0|127] "" XXX
 SG_ REL_SPEED : 88|14@1- (0.01,0) [0|16383] "" XXX
 SG_ NEW_SIGNAL_4 : 103|2@0+ (1,0) [0|3] "" XXX
 SG_ AZIMUTH_ACCEL : 104|13@1- (1,0) [0|8191] "" XXX
 SG_ REL_ACCEL : 118|10@1- (0.02,0) [0|1023] "" XXX
 SG_ NEW_SIGNAL_5 : 133|4@0+ (1,0) [0|15] "" XXX

BO_ 950 RADAR_TRACK_3B6: 24 RADAR
 SG_ CHECKSUM : 0|16@1+ (1,0) [0|65535] "" XXX
 SG_ COUNTER : 16|8@1+ (1,0) [0|255] "" XXX
 SG_ NEW_SIGNAL_1 : 25|2@0+ (1,0) [0|3] "" XXX
 SG_ NEW_SIGNAL_3 : 28|2@0+ (1,0) [0|3] "" XXX
 SG_ COUNTER_3 : 31|2@0+ (1,0) [0|3] "" XXX
 SG_ NEW_SIGNAL_2 : 38|7@0- (1,0) [0|127] "" XXX
 SG_ COUNTER_256 : 47|8@0+ (1,0) [0|255] "" XXX
 SG_ NEW_SIGNAL_6 : 51|4@0+ (1,0) [0|15] "" XXX
 SG_ STATE : 54|3@0+ (1,0) [0|7] "" XXX
 SG_ NEW_SIGNAL_8 : 62|7@0- (1,0) [0|127] "" XXX
 SG_ LONG_DIST : 63|12@1+ (0.1,0) [0|8191] "" XXX
 SG_ AZIMUTH : 76|12@1- (0.2,0) [0|127] "" XXX
 SG_ REL_SPEED : 88|14@1- (0.01,0) [0|16383] "" XXX
 SG_ NEW_SIGNAL_4 : 103|2@0+ (1,0) [0|3] "" XXX
 SG_ AZIMUTH_ACCEL : 104|13@1- (1,0) [0|8191] "" XXX
 SG_ REL_ACCEL : 118|10@1- (0.02,0) [0|1023] "" XXX
 SG_ NEW_SIGNAL_5 : 133|4@0+ (1,0) [0|15] "" XXX

BO_ 951 RADAR_TRACK_3B7: 24 RADAR
 SG_ CHECKSUM : 0|16@1+ (1,0) [0|65535] "" XXX
 SG_ COUNTER : 16|8@1+ (1,0) [0|255] "" XXX
 SG_ NEW_SIGNAL_1 : 25|2@0+ (1,0) [0|3] "" XXX
 SG_ NEW_SIGNAL_3 : 28|2@0+ (1,0) [0|3] "" XXX
 SG_ COUNTER_3 : 31|2@0+ (1,0) [0|3] "" XXX
 SG_ NEW_SIGNAL_2 : 38|7@0- (1,0) [0|127] "" XXX
 SG_ COUNTER_256 : 47|8@0+ (1,0) [0|255] "" XXX
 SG_ NEW_SIGNAL_6 : 51|4@0+ (1,0) [0|15] "" XXX
 SG_ STATE : 54|3@0+ (1,0) [0|7] "" XXX
 SG_ NEW_SIGNAL_8 : 62|7@0- (1,0) [0|127] "" XXX
 SG_ LONG_DIST : 63|12@1+ (0.1,0) [0|8191] "" XXX
 SG_ AZIMUTH : 76|12@1- (0.2,0) [0|127] "" XXX
 SG_ REL_SPEED : 88|14@1- (0.01,0) [0|16383] "" XXX
 SG_ NEW_SIGNAL_4 : 103|2@0+ (1,0) [0|3] "" XXX
 SG_ AZIMUTH_ACCEL : 104|13@1- (1,0) [0|8191] "" XXX
 SG_ REL_ACCEL : 118|10@1- (0.02,0) [0|1023] "" XXX
 SG_ NEW_SIGNAL_5 : 133|4@0+ (1,0) [0|15] "" XXX

BO_ 952 RADAR_TRACK_3B8: 24 RADAR
 SG_ CHECKSUM : 0|16@1+ (1,0) [0|65535] "" XXX
 SG_ COUNTER : 16|8@1+ (1,0) [0|255] "" XXX
 SG_ NEW_SIGNAL_1 : 25|2@0+ (1,0) [0|3] "" XXX
 SG_ NEW_SIGNAL_3 : 28|2@0+ (1,0) [0|3] "" XXX
 SG_ COUNTER_3 : 31|2@0+ (1,0) [0|3] "" XXX
 SG_ NEW_SIGNAL_2 : 38|7@0- (1,0) [0|127] "" XXX
 SG_ COUNTER_256 : 47|8@0+ (1,0) [0|255] "" XXX
 SG_ NEW_SIGNAL_6 : 51|4@0+ (1,0) [0|15] "" XXX
 SG_ STATE : 54|3@0+ (1,0) [0|7] "" XXX
 SG_ NEW_SIGNAL_8 : 62|7@0- (1,0) [0|127] "" XXX
 SG_ LONG_DIST : 63|12@1+ (0.1,0) [0|8191] "" XXX
 SG_ AZIMUTH : 76|12@1- (0.2,0) [0|127] "" XXX
 SG_ REL_SPEED : 88|14@1- (0.01,0) [0|16383] "" XXX
 SG_ NEW_SIGNAL_4 : 103|2@0+ (1,0) [0|3] "" XXX
 SG_ AZIMUTH_ACCEL : 104|13@1- (1,0) [0|8191] "" XXX
 SG_ REL_ACCEL : 118|10@1- (0.02,0) [0|1023] "" XXX
 SG_ NEW_SIGNAL_5 : 133|4@0+ (1,0) [0|15] "" XXX

BO_ 953 RADAR_TRACK_3B9: 24 RADAR
 SG_ CHECKSUM : 0|16@1+ (1,0) [0|65535] "" XXX
 SG_ COUNTER : 16|8@1+ (1,0) [0|255] "" XXX
 SG_ NEW_SIGNAL_1 : 25|2@0+ (1,0) [0|3] "" XXX
 SG_ NEW_SIGNAL_3 : 28|2@0+ (1,0) [0|3] "" XXX
 SG_ COUNTER_3 : 31|2@0+ (1,0) [0|3] "" XXX
 SG_ NEW_SIGNAL_2 : 38|7@0- (1,0) [0|127] "" XXX
 SG_ COUNTER_256 : 47|8@0+ (1,0) [0|255] "" XXX
 SG_ NEW_SIGNAL_6 : 51|4@0+ (1,0) [0|15] "" XXX
 SG_ STATE : 54|3@0+ (1,0) [0|7] "" XXX
 SG_ NEW_SIGNAL_8 : 62|7@0- (1,0) [0|127] "" XXX
 SG_ LONG_DIST : 63|12@1+ (0.1,0) [0|8191] "" XXX
 SG_ AZIMUTH : 76|12@1- (0.2,0) [0|127] "" XXX
 SG_ REL_SPEED : 88|14@1- (0.01,0) [0|16383] "" XXX
 SG_ NEW_SIGNAL_4 : 103|2@0+ (1,0) [0|3] "" XXX
 SG_ AZIMUTH_ACCEL : 104|13@1- (1,0) [0|8191] "" XXX
 SG_ REL_ACCEL : 118|10@1- (0.02,0) [0|1023] "" XXX
 SG_ NEW_SIGNAL_5 : 133|4@0+ (1,0) [0|15] "" XXX

BO_ 954 RADAR_TRACK_3BA: 24 RADAR
 SG_ CHECKSUM : 0|16@1+ (1,0) [0|65535] "" XXX
 SG_ COUNTER : 16|8@1+ (1,0) [0|255] "" XXX
 SG_ NEW_SIGNAL_1 : 25|2@0+ (1,0) [0|3] "" XXX
 SG_ NEW_SIGNAL_3 : 28|2@0+ (1,0) [0|3] "" XXX
 SG_ COUNTER_3 : 31|2@0+ (1,0) [0|3] "" XXX
 SG_ NEW_SIGNAL_2 : 38|7@0- (1,0) [0|127] "" XXX
 SG_ COUNTER_256 : 47|8@0+ (1,0) [0|255] "" XXX
 SG_ NEW_SIGNAL_6 : 51|4@0+ (1,0) [0|15] "" XXX
 SG_ STATE : 54|3@0+ (1,0) [0|7] "" XXX
 SG_ NEW_SIGNAL_8 : 62|7@0- (1,0) [0|127] "" XXX
 SG_ LONG_DIST : 63|12@1+ (0.1,0) [0|8191] "" XXX
 SG_ AZIMUTH : 76|12@1- (0.2,0) [0|127] "" XXX
 SG_ REL_SPEED : 88|14@1- (0.01,0) [0|16383] "" XXX
 SG_ NEW_SIGNAL_4 : 103|2@0+ (1,0) [0|3] "" XXX
 SG_ AZIMUTH_ACCEL : 104|13@1- (1,0) [0|8191] "" XXX
 SG_ REL_ACCEL : 118|10@1- (0.02,0) [0|1023] "" XXX
 SG_ NEW_SIGNAL_5 : 133|4@0+ (1,0) [0|15] "" XXX

BO_ 955 RADAR_TRACK_3BB: 24 RADAR
 SG_ CHECKSUM : 0|16@1+ (1,0) [0|65535] "" XXX
 SG_ COUNTER : 16|8@1+ (1,0) [0|255] "" XXX
 SG_ NEW_SIGNAL_1 : 25|2@0+ (1,0) [0|3] "" XXX
 SG_ NEW_SIGNAL_3 : 28|2@0+ (1,0) [0|3] "" XXX
 SG_ COUNTER_3 : 31|2@0+ (1,0) [0|3] "" XXX
 SG_ NEW_SIGNAL_2 : 38|7@0- (1,0) [0|127] "" XXX
 SG_ COUNTER_256 : 47|8@0+ (1,0) [0|255] "" XXX
 SG_ NEW_SIGNAL_6 : 51|4@0+ (1,0) [0|15] "" XXX
 SG_ STATE : 54|3@0+ (1,0) [0|7] "" XXX
 SG_ NEW_SIGNAL_8 : 62|7@0- (1,0) [0|127] "" XXX
 SG_ LONG_DIST : 63|12@1+ (0.1,0) [0|8191] "" XXX
 SG_ AZIMUTH : 76|12@1- (0.2,0) [0|127] "" XXX
 SG_ REL_SPEED : 88|14@1- (0.01,0) [0|16383] "" XXX
 SG_ NEW_SIGNAL_4 : 103|2@0+ (1,0) [0|3] "" XXX
 SG_ AZIMUTH_ACCEL : 104|13@1- (1,0) [0|8191] "" XXX
 SG_ REL_ACCEL : 118|10@1- (0.02,0) [0|1023] "" XXX
 SG_ NEW_SIGNAL_5 : 133|4@0+ (1,0) [0|15] "" XXX

BO_ 956 RADAR_TRACK_3BC: 24 RADAR
 SG_ CHECKSUM : 0|16@1+ (1,0) [0|65535] "" XXX
 SG_ COUNTER : 16|8@1+ (1,0) [0|255] "" XXX
 SG_ NEW_SIGNAL_1 : 25|2@0+ (1,0) [0|3] "" XXX
 SG_ NEW_SIGNAL_3 : 28|2@0+ (1,0) [0|3] "" XXX
 SG_ COUNTER_3 : 31|2@0+ (1,0) [0|3] "" XXX
 SG_ NEW_SIGNAL_2 : 38|7@0- (1,0) [0|127] "" XXX
 SG_ COUNTER_256 : 47|8@0+ (1,0) [0|255] "" XXX
 SG_ NEW_SIGNAL_6 : 51|4@0+ (1,0) [0|15] "" XXX
 SG_ STATE : 54|3@0+ (1,0) [0|7] "" XXX
 SG_ NEW_SIGNAL_8 : 62|7@0- (1,0) [0|127] "" XXX
 SG_ LONG_DIST : 63|12@1+ (0.1,0) [0|8191] "" XXX
 SG_ AZIMUTH : 76|12@1- (0.2,0) [0|127] "" XXX
 SG_ REL_SPEED : 88|14@1- (0.01,0) [0|16383] "" XXX
 SG_ NEW_SIGNAL_4 : 103|2@0+ (1,0) [0|3] "" XXX
 SG_ AZIMUTH_ACCEL : 104|13@1- (1,0) [0|8191] "" XXX
 SG_ REL_ACCEL : 118|10@1- (0.02,0) [0|1023] "" XXX
 SG_ NEW_SIGNAL_5 : 133|4@0+ (1,0) [0|15] "" XXX

BO_ 957 RADAR_TRACK_3BD: 24 RADAR
 SG_ CHECKSUM : 0|16@1+ (1,0) [0|65535] "" XXX
 SG_ COUNTER : 16|8@1+ (1,0) [0|255] "" XXX
 SG_ NEW_SIGNAL_1 : 25|2@0+ (1,0) [0|3] "" XXX
 SG_ NEW_SIGNAL_3 : 28|2@0+ (1,0) [0|3] "" XXX
 SG_ COUNTER_3 : 31|2@0+ (1,0) [0|3] "" XXX
 SG_ NEW_SIGNAL_2 : 38|7@0- (1,0) [0|127] "" XXX
 SG_ COUNTER_256 : 47|8@0+ (1,0) [0|255] "" XXX
 SG_ NEW_SIGNAL_6 : 51|4@0+ (1,0) [0|15] "" XXX
 SG_ STATE : 54|3@0+ (1,0) [0|7] "" XXX
 SG_ NEW_SIGNAL_8 : 62|7@0- (1,0) [0|127] "" XXX
 SG_ LONG_DIST : 63|12@1+ (0.1,0) [0|8191] "" XXX
 SG_ AZIMUTH : 76|12@1- (0.2,0) [0|127] "" XXX
 SG_ REL_SPEED : 88|14@1- (0.01,0) [0|16383] "" XXX
 SG_ NEW_SIGNAL_4 : 103|2@0+ (1,0) [0|3] "" XXX
 SG_ AZIMUTH_ACCEL : 104|13@1- (1,0) [0|8191] "" XXX
 SG_ REL_ACCEL : 118|10@1- (0.02,0) [0|1023] "" XXX
 SG_ NEW_SIGNAL_5 : 133|4@0+ (1,0) [0|15] "" XXX

BO_ 958 RADAR_TRACK_3BE: 24 RADAR
 SG_ CHECKSUM : 0|16@1+ (1,0) [0|65535] "" XXX
 SG_ COUNTER : 16|8@1+ (1,0) [0|255] "" XXX
 SG_ NEW_SIGNAL_1 : 25|2@0+ (1,0) [0|3] "" XXX
 SG_ NEW_SIGNAL_3 : 28|2@0+ (1,0) [0|3] "" XXX
 SG_ COUNTER_3 : 31|2@0+ (1,0) [0|3] "" XXX
 SG_ NEW_SIGNAL_2 : 38|7@0- (1,0) [0|127] "" XXX
 SG_ COUNTER_256 : 47|8@0+ (1,0) [0|255] "" XXX
 SG_ NEW_SIGNAL_6 : 51|4@0+ (1,0) [0|15] "" XXX
 SG_ STATE : 54|3@0+ (1,0) [0|7] "" XXX
 SG_ NEW_SIGNAL_8 : 62|7@0- (1,0) [0|127] "" XXX
 SG_ LONG_DIST : 63|12@1+ (0.1,0) [0|8191] "" XXX
 SG_ AZIMUTH : 76|12@1- (0.2,0) [0|127] "" XXX
 SG_ REL_SPEED : 88|14@1- (0.01,0) [0|16383] "" XXX
 SG_ NEW_SIGNAL_4 : 103|2@0+ (1,0) [0|3] "" XXX
 SG_ AZIMUTH_ACCEL : 104|13@1- (1,0) [0|8191] "" XXX
 SG_ REL_ACCEL : 118|10@1- (0.02,0) [0|1023] "" XXX
 SG_ NEW_SIGNAL_5 : 133|4@0+ (1,0) [0|15] "" XXX

BO_ 959 RADAR_TRACK_3BF: 24 RADAR
 SG_ CHECKSUM : 0|16@1+ (1,0) [0|65535] "" XXX
 SG_ COUNTER : 16|8@1+ (1,0) [0|255] "" XXX
 SG_ NEW_SIGNAL_1 : 25|2@0+ (1,0) [0|3] "" XXX
 SG_ NEW_SIGNAL_3 : 28|2@0+ (1,0) [0|3] "" XXX
 SG_ COUNTER_3 : 31|2@0+ (1,0) [0|3] "" XXX
 SG_ NEW_SIGNAL_2 : 38|7@0- (1,0) [0|127] "" XXX
 SG_ COUNTER_256 : 47|8@0+ (1,0) [0|255] "" XXX
 SG_ NEW_SIGNAL_6 : 51|4@0+ (1,0) [0|15] "" XXX
 SG_ STATE : 54|3@0+ (1,0) [0|7] "" XXX
 SG_ NEW_SIGNAL_8 : 62|7@0- (1,0) [0|127] "" XXX
 SG_ LONG_DIST : 63|12@1+ (0.1,0) [0|8191] "" XXX
 SG_ AZIMUTH : 76|12@1- (0.2,0) [0|127] "" XXX
 SG_ REL_SPEED : 88|14@1- (0.01,0) [0|16383] "" XXX
 SG_ NEW_SIGNAL_4 : 103|2@0+ (1,0) [0|3] "" XXX
 SG_ AZIMUTH_ACCEL : 104|13@1- (1,0) [0|8191] "" XXX
 SG_ REL_ACCEL : 118|10@1- (0.02,0) [0|1023] "" XXX
 SG_ NEW_SIGNAL_5 : 133|4@0+ (1,0) [0|15] "" XXX

BO_ 960 RADAR_TRACK_3C0: 24 RADAR
 SG_ CHECKSUM : 0|16@1+ (1,0) [0|65535] "" XXX
 SG_ COUNTER : 16|8@1+ (1,0) [0|255] "" XXX
 SG_ NEW_SIGNAL_1 : 25|2@0+ (1,0) [0|3] "" XXX
 SG_ NEW_SIGNAL_3 : 28|2@0+ (1,0) [0|3] "" XXX
 SG_ COUNTER_3 : 31|2@0+ (1,0) [0|3] "" XXX
 SG_ NEW_SIGNAL_2 : 38|7@0- (1,0) [0|127] "" XXX
 SG_ COUNTER_256 : 47|8@0+ (1,0) [0|255] "" XXX
 SG_ NEW_SIGNAL_6 : 51|4@0+ (1,0) [0|15] "" XXX
 SG_ STATE : 54|3@0+ (1,0) [0|7] "" XXX
 SG_ NEW_SIGNAL_8 : 62|7@0- (1,0) [0|127] "" XXX
 SG_ LONG_DIST : 63|12@1+ (0.1,0) [0|8191] "" XXX
 SG_ AZIMUTH : 76|12@1- (0.2,0) [0|127] "" XXX
 SG_ REL_SPEED : 88|14@1- (0.01,0) [0|16383] "" XXX
 SG_ NEW_SIGNAL_4 : 103|2@0+ (1,0) [0|3] "" XXX
 SG_ AZIMUTH_ACCEL : 104|13@1- (1,0) [0|8191] "" XXX
 SG_ REL_ACCEL : 118|10@1- (0.02,0) [0|1023] "" XXX
 SG_ NEW_SIGNAL_5 : 133|4@0+ (1,0) [0|15] "" XXX

BO_ 961 RADAR_TRACK_3C1: 24 RADAR
 SG_ CHECKSUM : 0|16@1+ (1,0) [0|65535] "" XXX
 SG_ COUNTER : 16|8@1+ (1,0) [0|255] "" XXX
 SG_ NEW_SIGNAL_1 : 25|2@0+ (1,0) [0|3] "" XXX
 SG_ NEW_SIGNAL_3 : 28|2@0+ (1,0) [0|3] "" XXX
 SG_ COUNTER_3 : 31|2@0+ (1,0) [0|3] "" XXX
 SG_ NEW_SIGNAL_2 : 38|7@0- (1,0) [0|127] "" XXX
 SG_ COUNTER_256 : 47|8@0+ (1,0) [0|255] "" XXX
 SG_ NEW_SIGNAL_6 : 51|4@0+ (1,0) [0|15] "" XXX
 SG_ STATE : 54|3@0+ (1,0) [0|7] "" XXX
 SG_ NEW_SIGNAL_8 : 62|7@0- (1,0) [0|127] "" XXX
 SG_ LONG_DIST : 63|12@1+ (0.1,0) [0|8191] "" XXX
 SG_ AZIMUTH : 76|12@1- (0.2,0) [0|127] "" XXX
 SG_ REL_SPEED : 88|14@1- (0.01,0) [0|16383] "" XXX
 SG_ NEW_SIGNAL_4 : 103|2@0+ (1,0) [0|3] "" XXX
 SG_ AZIMUTH_ACCEL : 104|13@1- (1,0) [0|8191] "" XXX
 SG_ REL_ACCEL : 118|10@1- (0.02,0) [0|1023] "" XXX
 SG_ NEW_SIGNAL_5 : 133|4@0+ (1,0) [0|15] "" XXX

BO_ 962 RADAR_TRACK_3C2: 24 RADAR
 SG_ CHECKSUM : 0|16@1+ (1,0) [0|65535] "" XXX
 SG_ COUNTER : 16|8@1+ (1,0) [0|255] "" XXX
 SG_ NEW_SIGNAL_1 : 25|2@0+ (1,0) [0|3] "" XXX
 SG_ NEW_SIGNAL_3 : 28|2@0+ (1,0) [0|3] "" XXX
 SG_ COUNTER_3 : 31|2@0+ (1,0) [0|3] "" XXX
 SG_ NEW_SIGNAL_2 : 38|7@0- (1,0) [0|127] "" XXX
 SG_ COUNTER_256 : 47|8@0+ (1,0) [0|255] "" XXX
 SG_ NEW_SIGNAL_6 : 51|4@0+ (1,0) [0|15] "" XXX
 SG_ STATE : 54|3@0+ (1,0) [0|7] "" XXX
 SG_ NEW_SIGNAL_8 : 62|7@0- (1,0) [0|127] "" XXX
 SG_ LONG_DIST : 63|12@1+ (0.1,0) [0|8191] "" XXX
 SG_ AZIMUTH : 76|12@1- (0.2,0) [0|127] "" XXX
 SG_ REL_SPEED : 88|14@1- (0.01,0) [0|16383] "" XXX
 SG_ NEW_SIGNAL_4 : 103|2@0+ (1,0) [0|3] "" XXX
 SG_ AZIMUTH_ACCEL : 104|13@1- (1,0) [0|8191] "" XXX
 SG_ REL_ACCEL : 118|10@1- (0.02,0) [0|1023] "" XXX
 SG_ NEW_SIGNAL_5 : 133|4@0+ (1,0) [0|15] "" XXX

BO_ 963 RADAR_TRACK_3C3: 24 RADAR
 SG_ CHECKSUM : 0|16@1+ (1,0) [0|65535] "" XXX
 SG_ COUNTER : 16|8@1+ (1,0) [0|255] "" XXX
 SG_ NEW_SIGNAL_1 : 25|2@0+ (1,0) [0|3] "" XXX
 SG_ NEW_SIGNAL_3 : 28|2@0+ (1,0) [0|3] "" XXX
 SG_ COUNTER_3 : 31|2@0+ (1,0) [0|3] "" XXX
 SG_ NEW_SIGNAL_2 : 38|7@0- (1,0) [0|127] "" XXX
 SG_ COUNTER_256 : 47|8@0+ (1,0) [0|255] "" XXX
 SG_ NEW_SIGNAL_6 : 51|4@0+ (1,0) [0|15] "" XXX
 SG_ STATE : 54|3@0+ (1,0) [0|7] "" XXX
 SG_ NEW_SIGNAL_8 : 62|7@0- (1,0) [0|127] "" XXX
 SG_ LONG_DIST : 63|12@1+ (0.1,0) [0|8191] "" XXX
 SG_ AZIMUTH : 76|12@1- (0.2,0) [0|127] "" XXX
 SG_ REL_SPEED : 88|14@1- (0.01,0) [0|16383] "" XXX
 SG_ NEW_SIGNAL_4 : 103|2@0+ (1,0) [0|3] "" XXX
 SG_ AZIMUTH_ACCEL : 104|13@1- (1,0) [0|8191] "" XXX
 SG_ REL_ACCEL : 118|10@1- (0.02,0) [0|1023] "" XXX
 SG_ NEW_SIGNAL_5 : 133|4@0+ (1,0) [0|15] "" XXX

BO_ 964 RADAR_TRACK_3C4: 24 RADAR
 SG_ CHECKSUM : 0|16@1+ (1,0) [0|65535] "" XXX
 SG_ COUNTER : 16|8@1+ (1,0) [0|255] "" XXX
 SG_ NEW_SIGNAL_1 : 25|2@0+ (1,0) [0|3] "" XXX
 SG_ NEW_SIGNAL_3 : 28|2@0+ (1,0) [0|3] "" XXX
 SG_ COUNTER_3 : 31|2@0+ (1,0) [0|3] "" XXX
 SG_ NEW_SIGNAL_2 : 38|7@0- (1,0) [0|127] "" XXX
 SG_ COUNTER_256 : 47|8@0+ (1,0) [0|255] "" XXX
 SG_ NEW_SIGNAL_6 : 51|4@0+ (1,0) [0|15] "" XXX
 SG_ STATE : 54|3@0+ (1,0) [0|7] "" XXX
 SG_ NEW_SIGNAL_8 : 62|7@0- (1,0) [0|127] "" XXX
 SG_ LONG_DIST : 63|12@1+ (0.1,0) [0|8191] "" XXX
 SG_ AZIMUTH : 76|12@1- (0.2,0) [0|127] "" XXX
 SG_ REL_SPEED : 88|14@1- (0.01,0) [0|16383] "" XXX
 SG_ NEW_SIGNAL_4 : 103|2@0+ (1,0) [0|3] "" XXX
 SG_ AZIMUTH_ACCEL : 104|13@1- (1,0) [0|8191] "" XXX
 SG_ REL_ACCEL : 118|10@1- (0.02,0) [0|1023] "" XXX
 SG_ NEW_SIGNAL_5 : 133|4@0+ (1,0) [0|15] "" XXX
