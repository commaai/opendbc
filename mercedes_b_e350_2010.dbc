VERSION ""

NS_ :

BS_:

BU_: XXX

BO_ 3 NEW_MSG_1: 8 XXX
 SG_ STEERING_ANGLE : 7|32@0- (1,0) [0|4294967295] "" XXX

BO_ 5 NEW_MSG_2: 8 XXX
 SG_ BRAKE_POSITION : 23|16@0+ (1,0) [0|65535] "" XXX
 SG_ BRAKE_PRESSED? : 0|8@1+ (1,0) [0|17] "" XXX

CM_ SG_ 5 BRAKE_PRESSED? "appears to be boolean (brake pressed)";
