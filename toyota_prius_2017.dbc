VERSION ""

NS_ :

BS_:

BU_: XXX

BO_ 528 NEW_MSG_1: 8 XXX
 SG_ NEW_SIGNAL_1 : 15|16@0- (1,0) [0|65535] "" XXX
 SG_ NEW_SIGNAL_2 : 7|8@0+ (1,0) [0|255] "" XXX
